## CMakeLists.txt
```
# (C) Copyright 2024, SECO Mind Srl
#
# SPDX-License-Identifier: Apache-2.0

cmake_minimum_required(VERSION 3.20.0)

set(REQUIRED_BOARD "native_sim")
set(CMAKE_EXPORT_COMPILE_COMMANDS ON)

if(NOT BOARD STREQUAL REQUIRED_BOARD)
  message(FATAL_ERROR "End to end tests cannot run on any other board besides ${REQUIRED_BOARD}.")
endif()

set(COMMON_DIR ../samples/common)

include(${COMMON_DIR}/Utils.cmake)

# add private conf file
concat_if_exists(private.conf EXTRA_CONF_FILE)

find_package(Zephyr REQUIRED HINTS $ENV{ZEPHYR_BASE})
project(e2e_test)

# handle generating certificate inc file
include(certificate.cmake)

# add common source files
set(app_common_sources ${COMMON_DIR}/src/utils.c ${COMMON_DIR}/src/eth.c)
target_sources(app PRIVATE ${app_common_sources})
target_include_directories(app PRIVATE ${COMMON_DIR}/include)

# add generated interfaces file
FILE(GLOB app_interfaces_sources interfaces/*.c)
target_sources(app PRIVATE ${app_interfaces_sources})
target_include_directories(app PRIVATE interfaces)

# add astarte private headers
target_include_directories(app PRIVATE ${CMAKE_SOURCE_DIR}/../lib/astarte_device_sdk/include)

# add sources
FILE(GLOB app_sources src/*.c)
target_sources(app PRIVATE ${app_sources})
target_include_directories(app PRIVATE include)
```

## Kconfig
```
# (C) Copyright 2024, SECO Mind Srl
#
# SPDX-License-Identifier: Apache-2.0
#
# This file is the application Kconfig entry point. All application Kconfig
# options can be defined here or included via other application Kconfig files.
# You can browse these options using the west targets menuconfig (terminal) or
# guiconfig (GUI).

menu "Zephyr"
source "Kconfig.zephyr"
endmenu

rsource "../Kconfig"

menu "E2E test"

config TLS_CERTIFICATE_PATH
	string "Path of the tls certificate"
	help
	  Path to a certificate in PEM format. it will be included in the binary and used for TLS
	  authentication.
	  This path should be relative to the end to end project folder.

config DEVICE_ID
	string "Astarte device ID"
    default ""
	help
	  Device ID to be used to connect to Astarte.

config CREDENTIAL_SECRET
    string "Astarte credential secret"
    default ""
    help
        The credential secret to be used to connect to Astarte.

config E2E_APPENGINE_TOKEN
	string "Token to access appengine APIs"
    default ""
	help
	  Token used to access the Astarte appengine APIs.

config E2E_APPENGINE_URL
    string "Url of the appengine APIs"
    default ""
    help
        Url of the appengine APIs exposed by astarte

config LOG_ONLY
    bool "Enable device log only mode"
    default n
    help
        Incoming astarte server messages will only be logged and no check will be
        performed against incoming data

config DEVICE_THREAD_STACK_SIZE
    int "Device thread stack size (Bytes)"
    default 8192
    help
        Use this setting to change the size of the stack for the thread running the Astarte device.

config DEVICE_THREAD_PRIORITY
    int "Device thread priority"
    default 0
    help
        Use this setting to change the priority of the thread running the Astarte device.

config DEVICE_POLL_PERIOD_MS
    int "Device thread polling period (ms)"
    default 100
    help
        Use this setting to change the polling period for the Astarte device.

config ETH_POLL_PERIOD_MS
    int "Device thread polling period (ms)"
    default 100
    help
        Use this setting to change the polling period for the ethernet connection.

config MQTT_CONNECTION_TIMEOUT_MS
    int "MQTT connection timeout (ms)"
    default 3000
    help
        Use this setting to change the MQTT connection timeout.

config MQTT_POLL_TIMEOUT_MS
    int "MQTT subsequent polling timeout (ms)"
    default 200
    help
        Use this setting to change the MQTT polling timeout.

config HTTP_TIMEOUT_MS
    int "HTTP operations timeout (ms)"
    default 3000
    help
        Use this setting to change the timeout for HTTP requests.

menu "Logging options"

module = APP
module-str = APP
source "subsys/logging/Kconfig.template.log_config"

module = RUNNER
module-str = Log level for e2e runner and command handler
module-help = Sets log level for e2e runner and command handler
source "subsys/logging/Kconfig.template.log_config"

module = IDATA
module-str = Log level for e2e idata functions
module-help = Sets log level for e2e idata functions
source "subsys/logging/Kconfig.template.log_config"

module = DATA
module-str = Log level for e2e data functions
module-help = Sets log level for e2e data functions
source "subsys/logging/Kconfig.template.log_config"

module = UTILITIES
module-str = Log level for e2e utilities functions
module-help = Sets log level for e2e utilities functions
source "subsys/logging/Kconfig.template.log_config"

module = SHELL_HANDLERS
module-str = Log level for shell handlers
module-help = Sets log level for zephyr shell handlers
source "subsys/logging/Kconfig.template.log_config"

module = DEVICE_HANDLER
module-str = Log level for device handler
module-help = Sets log level for zephyr device handler
source "subsys/logging/Kconfig.template.log_config"

endmenu

endmenu
```

## prj.conf
```kconfig
# (C) Copyright 2024, SECO Mind Srl
#
# SPDX-License-Identifier: Apache-2.0
#
# This is a Kconfig fragment which can be used to enable debug-related options
# in the application. See the README for more details.

# Increase size for heap allocation space
CONFIG_COMMON_LIBC_MALLOC_ARENA_SIZE=32768

# Increase the UART RX ring buffer to handle long automated commands
CONFIG_SHELL_BACKEND_SERIAL_RX_RING_BUFFER_SIZE=1024
# Ensure the shell command buffer is large enough
CONFIG_SHELL_CMD_BUFF_SIZE=1024
# Prevent the terminal from line-wrapping the echo, which breaks Twister's regex
CONFIG_SHELL_DEFAULT_TERMINAL_WIDTH=1024

CONFIG_SHELL=y
CONFIG_SHELL_BACKEND_SERIAL=y
CONFIG_SHELL_BACKEND_SERIAL_LOG_LEVEL_DBG=y

CONFIG_TLS_CERTIFICATE_PATH="certificate/api-eu1-astarte-cloud.pem"

CONFIG_DEBUG_OPTIMIZATIONS=y
CONFIG_MBEDTLS_DEBUG=y

# Enables debug logging
CONFIG_APP_LOG_LEVEL_DBG=y
CONFIG_RUNNER_LOG_LEVEL_DBG=y
CONFIG_DATA_LOG_LEVEL_DBG=y
CONFIG_UTILITIES_LOG_LEVEL_DBG=y
CONFIG_SHELL_HANDLERS_LOG_LEVEL_DBG=y
CONFIG_DEVICE_HANDLER_LOG_LEVEL_DBG=y

# Astarte device SDK
CONFIG_ASTARTE_DEVICE_SDK=y
# The two certificate tags are the same as the root CA is the same for Astarte API and MQTT broker.
CONFIG_ASTARTE_DEVICE_SDK_HTTPS_CA_CERT_TAG=1
CONFIG_ASTARTE_DEVICE_SDK_MQTTS_CA_CERT_TAG=1
CONFIG_ASTARTE_DEVICE_SDK_CLIENT_CERT_TAG=2
# Enable sdk code generation
CONFIG_ASTARTE_DEVICE_SDK_ADVANCED_CODE_GENERATION=y
CONFIG_ASTARTE_DEVICE_SDK_ADVANCED_CODE_GENERATION_INTERFACE_DIRECTORY="interfaces/"
# Logging
CONFIG_ASTARTE_DEVICE_SDK_PAIRING_LOG_LEVEL_DBG=y
CONFIG_ASTARTE_DEVICE_SDK_CRYPTO_LOG_LEVEL_DBG=y
CONFIG_ASTARTE_DEVICE_SDK_HTTP_LOG_LEVEL_DBG=y
CONFIG_ASTARTE_DEVICE_SDK_DEVICE_LOG_LEVEL_DBG=y
CONFIG_ASTARTE_DEVICE_SDK_DEVICE_STORAGE_LOG_LEVEL_DBG=y
CONFIG_ASTARTE_DEVICE_SDK_UUID_LOG_LEVEL_DBG=y
CONFIG_ASTARTE_DEVICE_SDK_BSON_LOG_LEVEL_DBG=y
CONFIG_ASTARTE_DEVICE_SDK_INTROSPECTION_LOG_LEVEL_DBG=y
CONFIG_ASTARTE_DEVICE_SDK_DATA_LOG_LEVEL_DBG=y
CONFIG_ASTARTE_DEVICE_SDK_VALIDATION_LOG_LEVEL_DBG=y
CONFIG_ASTARTE_DEVICE_SDK_OBJECT_LOG_LEVEL_DBG=y
CONFIG_ASTARTE_DEVICE_SDK_MAPPING_LOG_LEVEL_DBG=y
CONFIG_ASTARTE_DEVICE_SDK_MQTT_LOG_LEVEL_DBG=y
CONFIG_ASTARTE_DEVICE_SDK_TLS_CREDENTIALS_LOG_LEVEL_DBG=y
CONFIG_ASTARTE_DEVICE_SDK_KV_STORAGE_LOG_LEVEL_DBG=y
CONFIG_ASTARTE_DEVICE_SDK_DEVICE_RX_LOG_LEVEL_DBG=y
CONFIG_ASTARTE_DEVICE_SDK_DEVICE_TX_LOG_LEVEL_DBG=y
CONFIG_ASTARTE_DEVICE_SDK_DEVICE_CONNECTION_LOG_LEVEL_DBG=y
CONFIG_ASTARTE_DEVICE_SDK_DEVICE_ID_LOG_LEVEL_DBG=y

# Enable logging with floating point support
CONFIG_LOG=y
CONFIG_CBPRINTF_FP_SUPPORT=y

# Increased stack size
CONFIG_MAIN_STACK_SIZE=16384

# Enable base64 encoding and decoding
CONFIG_BASE64=y

# Enable system hashmaps
CONFIG_SYS_HASH_MAP=y

# Enable JSON library
CONFIG_JSON_LIBRARY=y

# Enable entropy generator
CONFIG_ENTROPY_GENERATOR=y

# DNS resolver
CONFIG_DNS_RESOLVER=y
CONFIG_DNS_SERVER_IP_ADDRESSES=y
CONFIG_DNS_SERVER1="8.8.8.8" # Google DNS

# Base MbedTLS & heap configuration
CONFIG_MBEDTLS=y
CONFIG_MBEDTLS_BUILTIN=y
CONFIG_MBEDTLS_ENABLE_HEAP=y
CONFIG_MBEDTLS_HEAP_SIZE=55000

# Enable PSA Crypto Backend
CONFIG_PSA_CRYPTO=y
CONFIG_PSA_CRYPTO_ENABLE_ALL=y
CONFIG_MBEDTLS_PSA_CRYPTO_C=y

# TLS & X.509
CONFIG_MBEDTLS_SSL_MAX_CONTENT_LEN=16384
CONFIG_MBEDTLS_PEM_PARSE_C=y
CONFIG_MBEDTLS_PEM_WRITE_C=y
CONFIG_MBEDTLS_BASE64_C=y
CONFIG_MBEDTLS_PK_WRITE_C=y
CONFIG_MBEDTLS_SSL_PROTO_TLS1_2=y
CONFIG_MBEDTLS_SSL_SERVER_NAME_INDICATION=y
CONFIG_MBEDTLS_X509_USE_C=y
CONFIG_MBEDTLS_X509_CRT_PARSE_C=y
CONFIG_MBEDTLS_X509_CRL_PARSE_C=y
CONFIG_MBEDTLS_X509_CSR_PARSE_C=y
CONFIG_MBEDTLS_X509_CSR_WRITE_C=y
CONFIG_MBEDTLS_PKCS5_C=y
CONFIG_MBEDTLS_KEY_EXCHANGE_ECDHE_ECDSA_ENABLED=y
CONFIG_MBEDTLS_KEY_EXCHANGE_ECDHE_RSA_ENABLED=y

# Enable networking
CONFIG_NETWORKING=y

# Sockets
CONFIG_NET_SOCKETS=y
CONFIG_NET_SOCKETS_POLL_MAX=4
CONFIG_NET_SOCKETS_SOCKOPT_TLS=y

# Use DHCP for IPv4 and IPv6
CONFIG_NET_DHCPV4=y
CONFIG_NET_DHCPV6=y

# Generic networking options
CONFIG_NET_TX_STACK_SIZE=4096
CONFIG_NET_RX_STACK_SIZE=4096
CONFIG_NET_PKT_RX_COUNT=20
CONFIG_NET_PKT_TX_COUNT=20
CONFIG_NET_BUF_RX_COUNT=40
CONFIG_NET_BUF_TX_COUNT=40
CONFIG_NET_MAX_CONTEXTS=20
CONFIG_NET_MAX_CONN=6
CONFIG_NET_MGMT=y
CONFIG_NET_MGMT_EVENT=y
CONFIG_NET_IPV4=y
CONFIG_NET_IPV6=y
CONFIG_NET_TCP=y

# Enable HTTP client
CONFIG_HTTP_CLIENT=y

# MQTT options
CONFIG_MQTT_LIB=y
CONFIG_MQTT_LIB_TLS=y
CONFIG_MQTT_KEEPALIVE=60

# Enable flash
CONFIG_FLASH=y
CONFIG_FLASH_MAP=y
CONFIG_FLASH_PAGE_LAYOUT=y

# Enable NVS
CONFIG_NVS=y
CONFIG_NVS_LOG_LEVEL_WRN=y

# Enable UUID
CONFIG_UUID=y
CONFIG_UUID_V4=y
CONFIG_UUID_V5=y
CONFIG_UUID_BASE64=y
```

## src/main.c
```c
/*
 * (C) Copyright 2024, SECO Mind Srl
 *
 * SPDX-License-Identifier: Apache-2.0
 */

#include <zephyr/kernel.h>
#include <zephyr/logging/log.h>
#include <zephyr/sys/atomic.h>
#include <zephyr/sys/util.h>
#include <zephyr/sys_clock.h>

#if defined(CONFIG_ARCH_POSIX)
#include <nsi_main.h>
#endif

#include <astarte_device_sdk/device_id.h>
#include <astarte_device_sdk/pairing.h>

#if !defined(CONFIG_ASTARTE_DEVICE_SDK_DEVELOP_USE_NON_TLS_HTTP)                                   \
    || !defined(CONFIG_ASTARTE_DEVICE_SDK_DEVELOP_USE_NON_TLS_MQTT)
#define NEEDS_TLS
#endif

#if defined(NEEDS_TLS)

// Enable mbed tls debug
#define MBEDTLS_DEBUG_C

#if defined(CONFIG_TLS_CERTIFICATE_PATH)
#include "ca_certificate_inc.h"
#else
#error TLS enabled but no generated certificate found: check the CONFIG_TLS_CERTIFICATE_PATH option
#endif

#include <mbedtls/debug.h>
#include <zephyr/net/tls_credentials.h>

#endif

#include "eth.h"

#include "runner.h"
#include "utilities.h"

LOG_MODULE_REGISTER(main, CONFIG_APP_LOG_LEVEL);

/************************************************
 *       Checks over configuration values       *
 ***********************************************/

#if !defined(CONFIG_ARCH_POSIX)
#error "The e2e test needs to run on the native_sim board"
#endif
BUILD_ASSERT(
    sizeof(CONFIG_DEVICE_ID) == ASTARTE_DEVICE_ID_LEN + 1, "Missing device ID in e2e tets");
BUILD_ASSERT(sizeof(CONFIG_CREDENTIAL_SECRET) == ASTARTE_PAIRING_CRED_SECR_LEN + 1,
    "Missing credential secret in e2e test");

/************************************************
 *   Constants, static variables and defines    *
 ***********************************************/

#define ETH_THREAD_STACK_SIZE 1024
K_THREAD_STACK_DEFINE(eth_thread_stack_area, ETH_THREAD_STACK_SIZE);
static struct k_thread eth_thread_data;
enum eth_thread_flags
{
    ETH_THREAD_TERMINATION_FLAG = 0,
};
static atomic_t eth_thread_flags;

/************************************************
 *         Static functions declaration         *
 ***********************************************/

static void eth_thread_entry_point(void *unused1, void *unused2, void *unused3);

/************************************************
 *         Global functions definition          *
 ***********************************************/

int main(void)
{
    LOG_INF("Astarte device end to end test");

    // Initialize Ethernet driver
    LOG_INF("Initializing Ethernet driver.");
    if (eth_connect() != 0) {
        LOG_ERR("Connectivity intialization failed!");
        return -1;
    }

#if defined(NEEDS_TLS)

    // Add TLS certificate
    tls_credential_add(CONFIG_ASTARTE_DEVICE_SDK_HTTPS_CA_CERT_TAG, TLS_CREDENTIAL_CA_CERTIFICATE,
        ca_certificate_root, ARRAY_SIZE(ca_certificate_root));

    // Enable mbedtls logging
    mbedtls_debug_set_threshold(1);

#endif

    LOG_INF("Spawning a new thread to poll the eth interface and check connectivity.");
    k_thread_create(&eth_thread_data, eth_thread_stack_area,
        K_THREAD_STACK_SIZEOF(eth_thread_stack_area), eth_thread_entry_point, NULL, NULL, NULL,
        CONFIG_DEVICE_THREAD_PRIORITY, 0, K_NO_WAIT);

    LOG_INF("Running the end to end test.");
    run_end_to_end_test();

    atomic_set_bit(&eth_thread_flags, ETH_THREAD_TERMINATION_FLAG);
    CHECK_HALT(k_thread_join(&eth_thread_data, K_FOREVER) != 0,
        "Failed in waiting for the eth polling thread to terminate.");

    LOG_INF("Returning from the end to end test.");

#if defined(CONFIG_ARCH_POSIX)
    // Required to terminate when on posix
    nsi_exit(0);
#endif
    return 0;
}

/************************************************
 *         Static functions definitions         *
 ***********************************************/

static void eth_thread_entry_point(void *unused1, void *unused2, void *unused3)
{
    ARG_UNUSED(unused1);
    ARG_UNUSED(unused2);
    ARG_UNUSED(unused3);

    LOG_INF("Started the eth polling thread");

    while (!atomic_test_bit(&eth_thread_flags, ETH_THREAD_TERMINATION_FLAG)) {
        k_timepoint_t timepoint = sys_timepoint_calc(K_MSEC(CONFIG_ETH_POLL_PERIOD_MS));

        eth_poll();

        k_sleep(sys_timepoint_timeout(timepoint));
    }
}
```

## include/data.h
```c
/*
 * (C) Copyright 2024, SECO Mind Srl
 *
 * SPDX-License-Identifier: Apache-2.0
 */

#ifndef DATA_H
#define DATA_H

#include <astarte_device_sdk/data.h>
#include <astarte_device_sdk/interface.h>
#include <astarte_device_sdk/object.h>

// TODO: move this to the utils
typedef struct
{
    const uint8_t *buf;
    size_t len;
} byte_array_t;

// TODO: move this to the utils
typedef struct
{
    int64_t value;
    bool present;
} optional_int64_t;

void data_init(const astarte_interface_t *interfaces[], size_t interfaces_len);
size_t data_size(const astarte_interface_t *interfaces[], size_t interfaces_len);
const astarte_interface_t *data_get_interface(const char *interface_name, size_t len);
int data_add_individual(const astarte_interface_t *interface, const char *path,
    const astarte_data_t *data, const optional_int64_t *timestamp);
int data_add_object(const astarte_interface_t *interface, const char *path,
    const byte_array_t *value, const astarte_object_entry_t *entries, size_t entries_length,
    const optional_int64_t *timestamp);
int data_add_set_property(
    const astarte_interface_t *interface, const char *path, const astarte_data_t *data);
int data_add_unset_property(const astarte_interface_t *interface, const char *path);

int data_expected_individual(
    const char *interface_name, const char *path, const astarte_data_t *data);
int data_expected_object(const char *interface_name, const char *path,
    const astarte_object_entry_t *entries, size_t entries_length);
int data_expected_set_property(
    const char *interface_name, const char *path, const astarte_data_t *data);
int data_expected_unset_property(const char *interface_name, const char *path);

#endif // DATA_H
```

## include/device_handler.h
```c
/*
 * (C) Copyright 2025, SECO Mind Srl
 *
 * SPDX-License-Identifier: Apache-2.0
 */

#ifndef DEVICE_HANDLER_H
#define DEVICE_HANDLER_H

#include <astarte_device_sdk/device.h>

void setup_device(void *data);
void free_device();
// NOTE: this is a highly insecure design pattern. Will be left for compatibility.
// TODO: Improve this API to avoid passing externally the device handle.
astarte_device_handle_t get_device();
void wait_for_device_connection();
void disconnect_device();
void wait_for_device_disconnection();
uint64_t perfect_hash_device_interface(const char *interface_name, size_t len);

#endif /* DEVICE_HANDLER_H */
```

## include/shell_handlers.h
```c
/*
 * (C) Copyright 2025, SECO Mind Srl
 *
 * SPDX-License-Identifier: Apache-2.0
 */

#ifndef SHELL_HANDLERS_H
#define SHELL_HANDLERS_H

#include <astarte_device_sdk/device.h>

// NOTE: Passing the device handle around like this is highly unsafe
void init_shell(astarte_device_handle_t device_handle);

#endif /* SHELL_HANDLERS_H */
```

## include/shell_macros.h
```c
/*
 * (C) Copyright 2025, SECO Mind Srl
 *
 * SPDX-License-Identifier: Apache-2.0
 */

#ifndef SHELL_MACROS_H
#define SHELL_MACROS_H

#define SHELL_IS_READY "Device shell ready"
#define SHELL_IS_CLOSING "Device shell closing"

#endif /* SHELL_MACROS_H */
```

## include/utilities.h
```c
/*
 * (C) Copyright 2024, SECO Mind Srl
 *
 * SPDX-License-Identifier: Apache-2.0
 */

#ifndef UTILITIES_H
#define UTILITIES_H

#include <stdint.h>

#include <zephyr/fatal.h>
#include <zephyr/shell/shell.h>

#include <astarte_device_sdk/data.h>
#include <astarte_device_sdk/interface.h>
#include <astarte_device_sdk/object.h>

#define CHECK_HALT(expr, ...)                                                                      \
    if (expr) {                                                                                    \
        LOG_ERR(__VA_ARGS__);                                                                      \
        k_fatal_halt(-1);                                                                          \
    }

#define CHECK_ASTARTE_OK_HALT(expr, ...) CHECK_HALT(expr != ASTARTE_RESULT_OK, __VA_ARGS__)

#define CHECK_RET_1(expr, ...)                                                                     \
    if (expr) {                                                                                    \
        __VA_OPT__(LOG_ERR(__VA_ARGS__));                                                          \
        return 1;                                                                                  \
    }

#define CHECK_ASTARTE_OK_RET_1(expr, ...) CHECK_RET_1(expr != ASTARTE_RESULT_OK, __VA_ARGS__)

#define CHECK_GOTO(expr, label, ...)                                                               \
    if (expr) {                                                                                    \
        LOG_ERR(__VA_ARGS__);                                                                      \
        goto label;                                                                                \
    }

#define CHECK_ASTARTE_OK_GOTO(expr, label, ...)                                                    \
    CHECK_GOTO(expr != ASTARTE_RESULT_OK, label, __VA_ARGS__)

typedef struct
{
    const uint8_t *buf;
    size_t len;
} byte_array_t;

typedef struct
{
    int64_t value;
    bool present;
} optional_int64_t;

bool astarte_data_are_equal(const astarte_data_t *left, const astarte_data_t *right);
bool astarte_objects_are_equal(const astarte_object_entry_t *left_entries,
    size_t left_entries_length, const astarte_object_entry_t *right_entries,
    size_t right_entries_length);

#endif /* UTILITIES_H */
```

## src/data.c
```c
/*
 * (C) Copyright 2026, SECO Mind Srl
 *
 * SPDX-License-Identifier: Apache-2.0
 */

#include "data.h"

#include <zephyr/logging/log.h>
#include <zephyr/sys/hash_map.h>
#include <zephyr/sys/hash_map_api.h>
#include <zephyr/sys/spsc_lockfree.h>

#include <data/deserialize.h>
#include <object_private.h>

#include "device_handler.h"
#include "utilities.h"

/************************************************
 *   Constants, static variables and defines    *
 ***********************************************/

LOG_MODULE_REGISTER(e2e_data, CONFIG_DATA_LOG_LEVEL);

enum message_type
{
    INDIVIDUAL,
    OBJECT,
    SET_PROPERTY,
    UNSET_PROPERTY,
};

typedef struct
{
    enum message_type type;
    const char *path;
    astarte_data_t data;
    byte_array_t raw_bson_data;
    astarte_object_entry_t *entries;
    size_t entries_length;
} message_t;

SPSC_DECLARE(messages, message_t);

typedef struct
{
    const astarte_interface_t *interface;
    struct spsc_messages messages;
    message_t messages_buf[2];
} map_value_t;

SYS_HASHMAP_DEFINE_STATIC(interface_map);

/************************************************
 *         Static functions declaration         *
 ***********************************************/

void free_map_entry_callback(uint64_t key, uint64_t value, void *cookie);

/************************************************
 *         Global functions definition          *
 ***********************************************/

void data_init(const astarte_interface_t *interfaces[], size_t interfaces_len)
{
    CHECK_HALT(
        !sys_hashmap_is_empty(&interface_map), "Attempting to initialize non empty device data");

    for (size_t i = 0; i < interfaces_len; ++i) {

        uint64_t key
            = perfect_hash_device_interface(interfaces[i]->name, strlen(interfaces[i]->name));

        map_value_t *value = calloc(1, sizeof(map_value_t));
        CHECK_HALT(!value, "Could not allocate value required memory");
        value->interface = interfaces[i];
        struct spsc_messages tmp_spsc
            = SPSC_INITIALIZER(ARRAY_SIZE(value->messages_buf), value->messages_buf);
        memcpy(&value->messages, &tmp_spsc, sizeof(struct spsc_messages));

        sys_hashmap_insert(&interface_map, key, POINTER_TO_UINT(value), NULL);
    }
}

void data_free()
{
    sys_hashmap_clear(&interface_map, free_map_entry_callback, NULL);
}

size_t data_size(const astarte_interface_t *interfaces[], size_t interfaces_len)
{
    size_t not_received_count = 0;
    LOG_INF("Checking remaining expected messagges");

    for (size_t i = 0; i < interfaces_len; ++i) {
        const astarte_interface_t *interface = interfaces[i];

        uint64_t key = perfect_hash_device_interface(interface->name, strlen(interface->name));
        uint64_t map_value_p = { 0 };

        CHECK_HALT(!sys_hashmap_get(&interface_map, key, &map_value_p),
            "Extracting data from an unknown interface");

        map_value_t *map_value = UINT_TO_POINTER(map_value_p);

        not_received_count += spsc_consumable(&map_value->messages);
    }

    LOG_INF("Count of expected messages: %zu", not_received_count);
    return not_received_count;
}

const astarte_interface_t *data_get_interface(const char *interface_name, size_t len)
{
    uint64_t key = perfect_hash_device_interface(interface_name, len);
    uint64_t value = { 0 };

    if (sys_hashmap_get(&interface_map, key, &value)) {
        map_value_t *map_value = UINT_TO_POINTER(value);
        return map_value->interface;
    }

    return NULL;
}

int data_add_individual(const astarte_interface_t *interface, const char *path,
    const astarte_data_t *data, const optional_int64_t *timestamp)
{
    uint64_t key = perfect_hash_device_interface(interface->name, strlen(interface->name));
    uint64_t map_value_p = 0;

    if (!sys_hashmap_get(&interface_map, key, &map_value_p)) {
        LOG_ERR("Adding data from an unknown interface");
        return 1;
    }

    map_value_t *map_value = UINT_TO_POINTER(map_value_p);

    message_t *message = spsc_acquire(&map_value->messages);
    CHECK_RET_1(message == NULL, "Space for expected messages is exhausted");
    message->type = INDIVIDUAL;
    message->path = path;
    message->data = *data;
    spsc_produce(&map_value->messages);

    LOG_INF("Added individual to the expected list.");

    return 0;
}

int data_add_object(const astarte_interface_t *interface, const char *path,
    const byte_array_t *value, astarte_object_entry_t *entries, size_t entries_length,
    const optional_int64_t *timestamp)
{
    uint64_t key = perfect_hash_device_interface(interface->name, strlen(interface->name));
    uint64_t map_value_p = 0;

    if (!sys_hashmap_get(&interface_map, key, &map_value_p)) {
        LOG_ERR("Adding data from an unknown interface");
        return 1;
    }

    map_value_t *map_value = UINT_TO_POINTER(map_value_p);

    message_t *message = spsc_acquire(&map_value->messages);
    CHECK_RET_1(message == NULL, "Space for expected messages is exhausted");
    message->type = OBJECT;
    message->path = path;
    // The object data has been deserialized into object entries.
    // However, for the objects the deserialization is partially performed shallowly.
    // As a consequence the original raw bson should be preserved.
    // This is not an issue for individuals and properties, where the deserialization is complete
    // and the original bson can be discarded.
    message->raw_bson_data = *value;
    message->entries = entries;
    message->entries_length = entries_length;
    spsc_produce(&map_value->messages);

    LOG_INF("Added object to the expected list.");

    return 0;
}

int data_add_set_property(
    const astarte_interface_t *interface, const char *path, const astarte_data_t *data)
{
    uint64_t key = perfect_hash_device_interface(interface->name, strlen(interface->name));
    uint64_t map_value_p = { 0 };

    if (!sys_hashmap_get(&interface_map, key, &map_value_p)) {
        LOG_ERR("Adding data from an unknown interface");
        return 1;
    }

    map_value_t *map_value = UINT_TO_POINTER(map_value_p);

    message_t *message = spsc_acquire(&map_value->messages);
    CHECK_RET_1(message == NULL, "Space for expected messages is exhausted");
    message->type = SET_PROPERTY;
    message->path = path;
    message->data = *data;
    spsc_produce(&map_value->messages);

    LOG_INF("Added set property to the expected list.");

    return 0;
}

int data_add_unset_property(const astarte_interface_t *interface, const char *path)
{
    uint64_t key = perfect_hash_device_interface(interface->name, strlen(interface->name));
    uint64_t map_value_p = { 0 };

    if (!sys_hashmap_get(&interface_map, key, &map_value_p)) {
        LOG_ERR("Adding data from an unknown interface");
        return 1;
    }

    map_value_t *map_value = UINT_TO_POINTER(map_value_p);

    message_t *message = spsc_acquire(&map_value->messages);
    CHECK_RET_1(message == NULL, "Space for expected messages is exhausted");
    message->type = UNSET_PROPERTY;
    message->path = path;
    spsc_produce(&map_value->messages);

    LOG_INF("Added unset property to the expected list.");

    return 0;
}

int data_expected_individual(
    const char *interface_name, const char *path, const astarte_data_t *data)
{
    uint64_t key = perfect_hash_device_interface(interface_name, strlen(interface_name));
    uint64_t map_value_p = { 0 };

    if (!sys_hashmap_get(&interface_map, key, &map_value_p)) {
        LOG_ERR("Extracting data from an unknown interface");
        return 1;
    }

    map_value_t *map_value = UINT_TO_POINTER(map_value_p);

    message_t *expected = spsc_peek(&map_value->messages);
    CHECK_RET_1(expected == NULL, "No more expected messages");

    CHECK_RET_1(
        expected->type != INDIVIDUAL, "Expected an individual but got a different message type");
    CHECK_RET_1(strcmp(expected->path, path) != 0, "Received path does not match expected one");

    // Compare the expected message payload with the received one
    CHECK_RET_1(!astarte_data_are_equal(&expected->data, data), "Unexpected element received");

    free((char *) expected->path);
    astarte_data_destroy_deserialized(expected->data);

    (void *) spsc_consume(&map_value->messages);
    spsc_release(&map_value->messages);

    LOG_INF("Individual received matched expected one");
    return 0;
}

int data_expected_object(const char *interface_name, const char *path,
    const astarte_object_entry_t *entries, size_t entries_length)
{
    uint64_t key = perfect_hash_device_interface(interface_name, strlen(interface_name));
    uint64_t map_value_p = { 0 };

    if (!sys_hashmap_get(&interface_map, key, &map_value_p)) {
        LOG_ERR("Extracting data from an unknown interface");
        return 1;
    }

    map_value_t *map_value = UINT_TO_POINTER(map_value_p);

    message_t *expected = spsc_peek(&map_value->messages);
    CHECK_RET_1(expected == NULL, "No more expected messages");

    CHECK_RET_1(expected->type != OBJECT, "Expected an object but got a different message type");
    CHECK_RET_1(strcmp(expected->path, path) != 0, "Received path does not match expected one");

    // Compare the expected message payload with the received one
    CHECK_RET_1(!astarte_objects_are_equal(
                    expected->entries, expected->entries_length, entries, entries_length),
        "Unexpected element received");

    free((char *) expected->path);
    free((void *) expected->raw_bson_data.buf);
    astarte_object_entries_destroy_deserialized(expected->entries, expected->entries_length);

    (void *) spsc_consume(&map_value->messages);
    spsc_release(&map_value->messages);

    LOG_INF("Object received matched expected one");
    return 0;
}

int data_expected_set_property(
    const char *interface_name, const char *path, const astarte_data_t *data)
{
    uint64_t key = perfect_hash_device_interface(interface_name, strlen(interface_name));
    uint64_t map_value_p = { 0 };

    if (!sys_hashmap_get(&interface_map, key, &map_value_p)) {
        LOG_ERR("Extracting data from an unknown interface");
        return 1;
    }

    map_value_t *map_value = UINT_TO_POINTER(map_value_p);

    message_t *expected = spsc_peek(&map_value->messages);
    CHECK_RET_1(expected == NULL, "No more expected messages");

    CHECK_RET_1(expected->type != SET_PROPERTY,
        "Expected an set property but got a different message type");
    CHECK_RET_1(strcmp(expected->path, path) != 0, "Received path does not match expected one");

    // Compare the expected message payload with the received one
    CHECK_RET_1(!astarte_data_are_equal(&expected->data, data), "Unexpected element received");

    free((char *) expected->path);
    astarte_data_destroy_deserialized(expected->data);

    (void *) spsc_consume(&map_value->messages);
    spsc_release(&map_value->messages);

    LOG_INF("Set property received matched expected one");
    return 0;
}

int data_expected_unset_property(const char *interface_name, const char *path)
{
    uint64_t key = perfect_hash_device_interface(interface_name, strlen(interface_name));
    uint64_t map_value_p = { 0 };

    if (!sys_hashmap_get(&interface_map, key, &map_value_p)) {
        LOG_ERR("Extracting data from an unknown interface");
        return 1;
    }

    map_value_t *map_value = UINT_TO_POINTER(map_value_p);

    message_t *expected = spsc_peek(&map_value->messages);
    CHECK_RET_1(expected == NULL, "No more expected messages");

    CHECK_RET_1(expected->type != UNSET_PROPERTY,
        "Expected an unset property but got a different message type");
    CHECK_RET_1(strcmp(expected->path, path) != 0, "Received path does not match expected one");

    free((char *) expected->path);

    (void *) spsc_consume(&map_value->messages);
    spsc_release(&map_value->messages);

    LOG_INF("Set property received matched expected one");
    return 0;
}

/************************************************
 *         Static functions definitions         *
 ***********************************************/

void free_map_entry_callback(uint64_t key, uint64_t value, void *cookie)
{
    map_value_t *map_value = UINT_TO_POINTER(value);

    for (message_t *message; (message = spsc_consume(&map_value->messages)) != NULL;) {
        free((char *) message->path);
        if ((message->type == INDIVIDUAL) || (message->type == SET_PROPERTY)) {
            astarte_data_destroy_deserialized(message->data);
        } else if (message->type == OBJECT) {
            free((void *) message->raw_bson_data.buf);
            astarte_object_entries_destroy_deserialized(message->entries, message->entries_length);
        }
        spsc_release(&map_value->messages);
    }

    free(map_value);
}
```

## src/device_handler.c
```c
/*
 * (C) Copyright 2025, SECO Mind Srl
 *
 * SPDX-License-Identifier: Apache-2.0
 */

#include "device_handler.h"

#include <zephyr/logging/log.h>
#include <zephyr/sys/atomic.h>

#include "astarte_device_sdk/device.h"
#include "utilities.h"
#include "zephyr/kernel.h"

#include "astarte_generated_interfaces.h"
#include "data.h"

LOG_MODULE_REGISTER(device_handler, CONFIG_DEVICE_HANDLER_LOG_LEVEL);

/************************************************
 *   Constants, static variables and defines    *
 ***********************************************/

#define GENERIC_WAIT_SLEEP_500_MS 500

static astarte_device_handle_t device_handle;

static const astarte_interface_t *device_interfaces[] = {
    &org_astarte_platform_zephyr_e2etest_DeviceAggregate,
    &org_astarte_platform_zephyr_e2etest_DeviceDatastream,
    &org_astarte_platform_zephyr_e2etest_DeviceProperty,
    &org_astarte_platform_zephyr_e2etest_ServerAggregate,
    &org_astarte_platform_zephyr_e2etest_ServerDatastream,
    &org_astarte_platform_zephyr_e2etest_ServerProperty,
};

K_THREAD_STACK_DEFINE(device_thread_stack_area, CONFIG_DEVICE_THREAD_STACK_SIZE);
static struct k_thread device_thread_data;
static atomic_t device_thread_flags;
enum device_thread_flags
{
    DEVICE_THREAD_CONNECTED_FLAG = 0,
    DEVICE_THREAD_TERMINATION_FLAG,
};

/************************************************
 *         Static functions declaration         *
 ***********************************************/

static void device_thread_entry_point(void *unused1, void *unused2, void *unused3);

static void connection_callback(astarte_device_connection_event_t event);
static void disconnection_callback(astarte_device_disconnection_event_t event);
static void device_individual_callback(astarte_device_datastream_individual_event_t event);
static void device_object_callback(astarte_device_datastream_object_event_t event);
static void device_property_set_callback(astarte_device_property_set_event_t event);
static void device_property_unset_callback(astarte_device_data_event_t event);

/************************************************
 *         Global functions definition          *
 ***********************************************/

void setup_device(void *data)
{
    LOG_INF("Creating static astarte_device.");

    CHECK_HALT(device_handle != NULL, "Attempting to create a device while a device is present.");

    data_init(device_interfaces, ARRAY_SIZE(device_interfaces));

    astarte_device_config_t config = {
        .device_id = CONFIG_DEVICE_ID,
        .cred_secr = CONFIG_CREDENTIAL_SECRET,
        .interfaces = device_interfaces,
        .interfaces_size = ARRAY_SIZE(device_interfaces),
        .http_timeout_ms = CONFIG_HTTP_TIMEOUT_MS,
        .mqtt_connection_timeout_ms = CONFIG_MQTT_CONNECTION_TIMEOUT_MS,
        .mqtt_poll_timeout_ms = CONFIG_MQTT_POLL_TIMEOUT_MS,
        .cbk_user_data = data,
        .connection_cbk = connection_callback,
        .disconnection_cbk = disconnection_callback,
        .datastream_individual_cbk = device_individual_callback,
        .datastream_object_cbk = device_object_callback,
        .property_set_cbk = device_property_set_callback,
        .property_unset_cbk = device_property_unset_callback,
    };

    CHECK_ASTARTE_OK_HALT(astarte_device_new(&config, &device_handle), "Device creation failure.");

    LOG_INF("Spawning a new thread to poll data from the Astarte device.");
    k_thread_create(&device_thread_data, device_thread_stack_area,
        K_THREAD_STACK_SIZEOF(device_thread_stack_area), device_thread_entry_point, NULL, NULL,
        NULL, CONFIG_DEVICE_THREAD_PRIORITY, 0, K_NO_WAIT);

    LOG_INF("Astarte device created.");
}

void free_device()
{
    atomic_set_bit(&device_thread_flags, DEVICE_THREAD_TERMINATION_FLAG);

    CHECK_HALT(k_thread_join(&device_thread_data, K_FOREVER) != 0,
        "Failed in waiting for the Astarte thread to terminate.");

    LOG_INF("Destroing Astarte device and freeing resources.");
    CHECK_ASTARTE_OK_HALT(astarte_device_destroy(device_handle), "Device destruction failure.");
    device_handle = NULL;
    LOG_INF("Astarte device destroyed.");
}

astarte_device_handle_t get_device()
{
    CHECK_HALT(device_handle == NULL, "Trying to get non existent device.");
    return device_handle;
}

void wait_for_device_connection()
{
    CHECK_HALT(device_handle == NULL, "Trying to wait on a non existent device.");
    while (!atomic_test_bit(&device_thread_flags, DEVICE_THREAD_CONNECTED_FLAG)) {
        k_sleep(K_MSEC(GENERIC_WAIT_SLEEP_500_MS));
    }
}

void disconnect_device()
{
    CHECK_HALT(device_handle == NULL, "Trying to disconnect a non existent device.");
    atomic_set_bit(&device_thread_flags, DEVICE_THREAD_TERMINATION_FLAG);
}

void wait_for_device_disconnection()
{
    while (atomic_test_bit(&device_thread_flags, DEVICE_THREAD_CONNECTED_FLAG)) {
        k_sleep(K_MSEC(GENERIC_WAIT_SLEEP_500_MS));
    }

    // Check that all devices expected messages have been received
    CHECK_HALT((data_size(device_interfaces, ARRAY_SIZE(device_interfaces)) > 0),
        "Some expected messages didn't get received");
}

// Computes a perfect hash for a device interface name
// NOTE: this depends on the names used in this case this works because we know the names of the
// interfaces.
// The konwn interfaces names are:
// - org.astarte-platform.zephyr.e2etest.ServerProperty
// - org.astarte-platform.zephyr.e2etest.DeviceProperty
// - org.astarte-platform.zephyr.e2etest.ServerAggregate
// - org.astarte-platform.zephyr.e2etest.DeviceAggregate
// - org.astarte-platform.zephyr.e2etest.ServerDatastream
// - org.astarte-platform.zephyr.e2etest.DeviceDatastream
uint64_t perfect_hash_device_interface(const char *interface_name, size_t len)
{

    const char base[] = "org.astarte-platform.zephyr.e2etest.";
    const size_t base_len = ARRAY_SIZE(base) - 1;

    CHECK_HALT(len <= 44 || strncmp(interface_name, base, base_len) != 0,
        "Received an invalid or unexpected interface name, please update the hash function");

    /* We extract:
     * Char at [36]: 'S' (Server) or 'D' (Device)
     * Char at [42]: 'P' (Property), 'A' (Aggregate), 'D' (Datastream)
     * Char at [43]: 'r', 'g', 'a'... (part of 'Property'/'Aggregate'/'Datastream')
     */
    uint32_t hash = ((uint32_t) interface_name[36] << 16) | ((uint32_t) interface_name[42] << 8)
        | ((uint32_t) interface_name[43]);

    return (uint64_t) hash;
}

/************************************************
 *         Static functions definitions         *
 ***********************************************/

static void device_thread_entry_point(void *unused1, void *unused2, void *unused3)
{
    ARG_UNUSED(unused1);
    ARG_UNUSED(unused2);
    ARG_UNUSED(unused3);

    LOG_INF("Started Astarte device thread.");

    CHECK_ASTARTE_OK_HALT(astarte_device_connect(device_handle), "Device connection failure.");

    while (!atomic_test_bit(&device_thread_flags, DEVICE_THREAD_TERMINATION_FLAG)) {
        k_timepoint_t timepoint = sys_timepoint_calc(K_MSEC(CONFIG_DEVICE_POLL_PERIOD_MS));

        astarte_result_t res = astarte_device_poll(device_handle);
        CHECK_HALT(
            res != ASTARTE_RESULT_TIMEOUT && res != ASTARTE_RESULT_OK, "Device poll failure.");

        k_sleep(sys_timepoint_timeout(timepoint));
    }

    CHECK_ASTARTE_OK_HALT(
        astarte_device_disconnect(device_handle, K_SECONDS(10)), "Device disconnection failure.");

    LOG_INF("Exiting from the polling thread.");
}

static void connection_callback(astarte_device_connection_event_t event)
{
    (void) event;
    LOG_INF("Astarte device connected");
    atomic_set_bit(&device_thread_flags, DEVICE_THREAD_CONNECTED_FLAG);
}

static void disconnection_callback(astarte_device_disconnection_event_t event)
{
    (void) event;
    LOG_INF("Astarte device disconnected");
    atomic_clear_bit(&device_thread_flags, DEVICE_THREAD_CONNECTED_FLAG);
}

static void device_individual_callback(astarte_device_datastream_individual_event_t event)
{
    LOG_INF("Individual datastream callback");

    CHECK_HALT(data_expected_individual(
                   event.base_event.interface_name, event.base_event.path, &event.data)
            != 0,
        "Received individual datastream does not match any expected one");
}

static void device_object_callback(astarte_device_datastream_object_event_t event)
{
    LOG_INF("Object datastream callback");

    CHECK_HALT(data_expected_object(event.base_event.interface_name, event.base_event.path,
                   event.entries, event.entries_len)
            != 0,
        "Received object datastream does not match any expected one");
}

static void device_property_set_callback(astarte_device_property_set_event_t event)
{
    LOG_INF("Property set callback");

    // CHECK_HALT(data_expected_set_property(
    //                event.base_event.interface_name, event.base_event.path, &event.data)
    //         != 0,
    //     "Received property set event does not match any expected one");
}

static void device_property_unset_callback(astarte_device_data_event_t event)
{
    LOG_INF("Property unset callback");

    CHECK_HALT(data_expected_unset_property(event.interface_name, event.path) != 0,
        "Received property unset event does not match any expected one");
}

// #define MAIN_THREAD_SLEEP_MS 500

// // static astarte_device_handle_t device_handle;
// K_SEM_DEFINE(device_sem, 1, 1);

// // LOG_MODULE_REGISTER(device_handler, CONFIG_DEVICE_HANDLER_LOG_LEVEL); // NOLINT

// static bool get_termination();
// // write flag DEVICE_THREAD_CONNECTED_FLAG
// static void set_connected();
// static void set_disconnected();
// // --

// void device_setup(astarte_device_config_t config)
// {
//     // // override with local callbacks
//     // config.connection_cbk = connection_callback;
//     // config.disconnection_cbk = disconnection_callback;

//     // astarte_device_handle_t temp_handle = NULL;
//     // CHECK_HALT(k_sem_count_get(&device_sem) == 0, "The device is already initialized");

//     // LOG_INF("Creating static astarte_device by calling astarte_device_new."); // NOLINT
//     // CHECK_ASTARTE_OK_HALT(
//     //     astarte_device_new(&config, &temp_handle), "Astarte device creation failure.");

//     // // we take the semaphore after initializing the device to make sure that errors from
//     // // astarte_device_new can be handled separately
//     // CHECK_HALT(k_sem_take(&device_sem, K_NO_WAIT) != 0,
//     //     "Could not take the semaphore, the device is already initialized");
//     // device_handle = temp_handle;

//     // LOG_INF("Spawning a new thread to poll data from the Astarte device."); // NOLINT
//     // k_thread_create(&device_thread_data, device_thread_stack_area,
//     //     K_THREAD_STACK_SIZEOF(device_thread_stack_area), device_thread_entry_point, NULL,
//     NULL,
//     //     NULL, CONFIG_DEVICE_THREAD_PRIORITY, 0, K_NO_WAIT);
// }

// // astarte_device_handle_t get_device()
// // {
// //     // CHECK_HALT(k_sem_count_get(&device_sem) > 0 || get_termination(),
// //     //     "The device is not initialized or is terminating");

// //     return device_handle;
// // }

// void set_termination()
// {
//     // atomic_set_bit(&device_thread_flags, DEVICE_THREAD_TERMINATION_FLAG);
// }

// void wait_for_connection()
// {
//     // while (!atomic_test_bit(&device_thread_flags, DEVICE_THREAD_CONNECTED_FLAG)) {
//     //     k_sleep(K_MSEC(MAIN_THREAD_SLEEP_MS));
//     // }
// }

// void wait_for_disconnection()
// {
//     // while (atomic_test_bit(&device_thread_flags, DEVICE_THREAD_CONNECTED_FLAG)) {
//     //     k_sleep(K_MSEC(MAIN_THREAD_SLEEP_MS));
//     // }
// }

// void free_device()
// {
//     set_termination();

//     CHECK_HALT(k_thread_join(&device_thread_data, K_FOREVER) != 0,
//         "Failed in waiting for the Astarte thread to terminate.");

//     LOG_INF("Destroing Astarte device and freeing resources."); // NOLINT
//     CHECK_ASTARTE_OK_HALT(
//         astarte_device_destroy(device_handle), "Astarte device destruction failure.");

//     LOG_INF("Astarte device destroyed."); // NOLINT

//     LOG_INF("Giving back the semaphore lock"); // NOLINT
//     // allow creating another device with `device_setup`
//     device_handle = NULL;
//     k_sem_give(&device_sem);
// }

// static bool get_termination()
// {
//     // return atomic_test_bit(&device_thread_flags, DEVICE_THREAD_TERMINATION_FLAG);
// }

// static void set_connected()
// {
//     // atomic_set_bit(&device_thread_flags, DEVICE_THREAD_CONNECTED_FLAG);
// }

// static void set_disconnected()
// {
//     // atomic_clear_bit(&device_thread_flags, DEVICE_THREAD_CONNECTED_FLAG);
// }

// static void connection_callback(astarte_device_connection_event_t event)
// {
//     (void) event;
//     LOG_INF("Astarte device connected"); // NOLINT
//     set_connected();
// }

// static void disconnection_callback(astarte_device_disconnection_event_t event)
// {
//     (void) event;
//     LOG_INF("Astarte device disconnected"); // NOLINT
//     set_disconnected();
// }

// static void device_thread_entry_point(void *unused1, void *unused2, void *unused3)
// {
//     ARG_UNUSED(unused1);
//     ARG_UNUSED(unused2);
//     ARG_UNUSED(unused3);

//     LOG_INF("Starting e2e device thread."); // NOLINT

//     CHECK_ASTARTE_OK_HALT(
//         astarte_device_connect(device_handle), "Astarte device connection failure.");

//     while (!get_termination()) {
//         k_timepoint_t timepoint = sys_timepoint_calc(K_MSEC(CONFIG_DEVICE_POLL_PERIOD_MS));

//         astarte_result_t res = astarte_device_poll(device_handle);
//         CHECK_HALT(res != ASTARTE_RESULT_TIMEOUT && res != ASTARTE_RESULT_OK,
//             "Astarte device poll failure.");

//         k_sleep(sys_timepoint_timeout(timepoint));
//     }

//     CHECK_ASTARTE_OK_HALT(astarte_device_disconnect(device_handle, K_SECONDS(10)),
//         "Astarte device disconnection failure.");

//     LOG_INF("Exiting from the polling thread."); // NOLINT
// }
```

## src/runner.c
```c
/*
 * (C) Copyright 2024, SECO Mind Srl
 *
 * SPDX-License-Identifier: Apache-2.0
 */

#include "runner.h"

#include <stdint.h>
#include <stdlib.h>
#include <string.h>

#include <zephyr/fatal.h>
#include <zephyr/kernel.h>
#include <zephyr/logging/log.h>
#include <zephyr/shell/shell.h>
#include <zephyr/shell/shell_uart.h>
#include <zephyr/sys/bitarray.h>
#include <zephyr/sys/util.h>

#include <astarte_device_sdk/data.h>
#include <astarte_device_sdk/device.h>
#include <astarte_device_sdk/interface.h>
#include <astarte_device_sdk/mapping.h>
#include <astarte_device_sdk/object.h>
#include <astarte_device_sdk/pairing.h>
#include <astarte_device_sdk/result.h>

#include "device_handler.h"
#include "shell_handlers.h"
#include "shell_macros.h"

LOG_MODULE_REGISTER(runner, CONFIG_RUNNER_LOG_LEVEL);

/************************************************
 *         Global functions definition          *
 ***********************************************/

void run_end_to_end_test()
{
    LOG_INF("End to end test runner");

#if CONFIG_LOG_ONLY
    LOG_WRN("Running with device callbacks in log only mode");
    LOG_WRN("Data received will NOT be checked against expected data");
#endif

    LOG_INF("Starting the device");
    setup_device();

    // Wait for the device connection
    LOG_INF("Waiting for the device to be connected");
    wait_for_device_connection();

    // We are ready to send and receive data
    const struct shell *uart_shell = shell_backend_uart_get_ptr();
    shell_start(uart_shell);

    // Pytest detects the readyness of the shell through this string
    shell_print(uart_shell, SHELL_IS_READY);

    // Wait untill a shell command disconnects the device
    wait_for_device_disconnection();

    // Pytest detects the a termination of the test through this string
    shell_print(uart_shell, SHELL_IS_CLOSING);
    shell_stop(uart_shell);

    // Free the device and epxected data structures after `shell_stop`
    free_device();

#if CONFIG_LOG_ONLY
    LOG_WRN("Test has been run with device callbacks in log only mode");
    LOG_WRN("Data received didn't get checked against expected data");
#endif
}
```

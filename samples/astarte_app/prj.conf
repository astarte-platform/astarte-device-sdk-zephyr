## Kconfig
```
# (C) Copyright 2024, SECO Mind Srl
#
# SPDX-License-Identifier: Apache-2.0
#
# This file is the application Kconfig entry point. All application Kconfig
# options can be defined here or included via other application Kconfig files.
# You can browse these options using the west targets menuconfig (terminal) or
# guiconfig (GUI).

menu "Zephyr"
source "Kconfig.zephyr"
endmenu

rsource "../../Kconfig"

menu "Sample application"

config DEVICE_ID
	string "Astarte device ID"
    default ""
	help
	  Device ID to be used to connect to Astarte.

config CREDENTIAL_SECRET
    string "Astarte credential secret"
    default ""
    depends on !DEVICE_REGISTRATION
    help
        The credential secret to be used to connect to Astarte.

config DEVICE_RX_THREAD_STACK_SIZE
    int "Device reception thread stack size (Bytes)"
    default 12288
    help
        Use this setting to change the size of the stack for the thread running the Astarte device
        receiving functionality.

config DEVICE_TX_THREAD_STACK_SIZE
    int "Device transmission thread stack size (Bytes)"
    default 2048
    help
        Use this setting to change the size of the stack for the thread running the Astarte device
        transmitting functionality.

config DEVICE_THREAD_PRIORITY
    int "Device thread(s) priority"
    default 0
    help
        Use this setting to change the priority of the receive and transmit threads running the
        Astarte device.

config DEVICE_POLL_PERIOD_MS
    int "Device thread polling period (ms)"
    default 100
    help
        Use this setting to change the polling period for the Astarte device.

config MQTT_CONNECTION_TIMEOUT_MS
    int "MQTT first polling timeout (ms)"
    default 3000
    help
        Use this setting to change the MQTT polling timeout for first polling operations.

config MQTT_POLL_TIMEOUT_MS
    int "MQTT subsequent polling timeout (ms)"
    default 500
    help
        Use this setting to change the MQTT polling timeout for subsequent polling operations.

config HTTP_TIMEOUT_MS
    int "HTTP operations timeout (ms)"
    default 3000
    help
        Use this setting to change the timeout for HTTP requests.

config DEVICE_OPERATIONAL_TIMEOUT
    int "Operational time in sedonds for which the device will stay connected to astarte"
    default 60
    depends on !DEVICE_INDIVIDUAL_TRANSMISSION
    depends on !DEVICE_OBJECT_TRANSMISSION
    depends on !DEVICE_PROPERTY_SET_TRANSMISSION
    depends on !DEVICE_PROPERTY_UNSET_TRANSMISSION
    help
        The device will stay connected to astarte for the specified number of seconds,
        after this time the device will be disconnected and the sample will end.
        This option gets automatically enabled when no transmission is configured to
        allow the device to wait for messages from the server.

menu "Registration"

config DEVICE_REGISTRATION
    bool "Enable device registration in the sample"
    default n
    help
        Use this setting to enable the registration of the device given a pairing jwt.
        The registration will use the defined jwt in ASTARTE_DEVICE_SDK_PAIRING_JWT.

endmenu

menu "Individual transmission"

config DEVICE_INDIVIDUAL_TRANSMISSION
    bool "Enable sample transmission of astarte individuals"
    default y
    help
        Use this setting to enable the transmission of astarte inviduals in the sample.

config DEVICE_INDIVIDUAL_TRANSMISSION_DELAY_SECONDS
    int "Device transmission delay (s)"
    default 10
    depends on DEVICE_INDIVIDUAL_TRANSMISSION
    help
        Use this setting to change how long to wait before sending individuals.
        This delay starts after the device connects to astarte: a delay of 0 means that all
        individuals will be sent just after a connection event.

endmenu

menu "Object transmission"

config DEVICE_OBJECT_TRANSMISSION
    bool "Enable sample transmission of astarte objects"
    default y
    help
        Use this setting to enable the transmission of astarte objects in the sample.

config DEVICE_OBJECT_TRANSMISSION_DELAY_SECONDS
    int "Device transmission delay (s)"
    default 10
    depends on DEVICE_OBJECT_TRANSMISSION
    help
        Use this setting to change how long to wait before sending objects.
        This delay starts after all individuals got sent: a delay of 0 means that all objects
        will be sent just after the individual got sent.

endmenu

menu "Property transmission"

config DEVICE_PROPERTY_SET_TRANSMISSION
    bool "Enable sample transmission of astarte properties set"
    default y
    help
        Use this setting to enable the transmission of astarte properties set in the sample.

config DEVICE_PROPERTY_SET_TRANSMISSION_DELAY_SECONDS
    int "Device transmission delay (s)"
    default 10
    depends on DEVICE_PROPERTY_SET_TRANSMISSION
    help
        Use this setting to change how long to wait before setting properties.
        This delay starts after all objects got sent: a delay of 0 means that all properties
        will be set just after the object got sent.

config DEVICE_PROPERTY_UNSET_TRANSMISSION
    bool "Enable sample transmission of astarte properties unset"
    default y
    help
        Use this setting to enable the transmission of astarte properties unset in the sample.

config DEVICE_PROPERTY_UNSET_TRANSMISSION_DELAY_SECONDS
    int "Send property unset transmission delay (s)"
    default 10
    depends on DEVICE_PROPERTY_UNSET_TRANSMISSION
    help
        Use this setting to change how long to wait before sending properties unsets.
        This delay starts after all properties got set: a delay of 0 means that all properties
        will be unset just after they got set.

endmenu

menu "Wifi configuration"

config WIFI_SSID
    string "WiFi SSID"
    default "myssid"
    help
        SSID (network name) for the example to connect to.

config WIFI_PASSWORD
    string "WiFi Password"
    default "mypassword"
    help
        WiFi password (WPA or WPA2) for the example to use.

endmenu

module = APP
module-str = APP
source "subsys/logging/Kconfig.template.log_config"

module = REGISTER
module-str = REGISTER
source "subsys/logging/Kconfig.template.log_config"

module = INDIVIDUAL
module-str = INDIVIDUAL
source "subsys/logging/Kconfig.template.log_config"

module = OBJECT
module-str = OBJECT
source "subsys/logging/Kconfig.template.log_config"

module = PROPERTY
module-str = PROPERTY
source "subsys/logging/Kconfig.template.log_config"

endmenu
```

## sample.yaml
```
# (C) Copyright 2024, SECO Mind Srl
#
# SPDX-License-Identifier: Apache-2.0
# This file is provided so that the application can be compiled using Twister,
# the Zephyr testing tool. In this file, multiple combinations can be specified,
# so that you can easily test all of them locally or in CI.

sample:
  description: Astarte application sample
  name: astarte-sample
tests:
  sample.default:
    build_only: true
    integration_platforms:
      - frdm_rw612
      - frdm_mcxn947/mcxn947/cpu0
      - mimxrt1060_evk@B/mimxrt1062/qspi
      - mimxrt1064_evk
      - stm32h573i_dk
      - native_sim
      - esp_wrover_kit/esp32/procpu
  sample.wifi:
    build_only: true
    extra_args: EXTRA_CONF_FILE="prj-wifi.conf"
    integration_platforms:
      - frdm_rw612
  sample.lts:
    build_only: true
    extra_args: CONF_FILE="zephyr-lts.conf"
    integration_platforms:
      - mimxrt1064_evk
      - stm32h573i_dk
```

## prj.conf
```kconfig
# (C) Copyright 2024, SECO Mind Srl
#
# SPDX-License-Identifier: Apache-2.0
#
# This is a Kconfig fragment which can be used to enable debug-related options
# in the application. See the README for more details.

# Astarte device SDK
CONFIG_ASTARTE_DEVICE_SDK=y
CONFIG_ASTARTE_DEVICE_SDK_HOSTNAME="."
# The two certificate tags are the same as the root CA is the same for Astarte API and MQTT broker.
CONFIG_ASTARTE_DEVICE_SDK_HTTPS_CA_CERT_TAG=1
CONFIG_ASTARTE_DEVICE_SDK_MQTTS_CA_CERT_TAG=1
CONFIG_ASTARTE_DEVICE_SDK_CLIENT_CERT_TAG=2
CONFIG_ASTARTE_DEVICE_SDK_PAIRING_JWT=""
CONFIG_ASTARTE_DEVICE_SDK_REALM_NAME="."

# WiFi credentials
CONFIG_WIFI_SSID=""
CONFIG_WIFI_PASSWORD=""

# Sample configuration
CONFIG_DEVICE_ID="......................"
CONFIG_CREDENTIAL_SECRET="............................................"

CONFIG_DEVICE_REGISTRATION=y
CONFIG_DEVICE_INDIVIDUAL_TRANSMISSION=y
CONFIG_DEVICE_OBJECT_TRANSMISSION=y
CONFIG_DEVICE_PROPERTY_SET_TRANSMISSION=y
CONFIG_DEVICE_PROPERTY_UNSET_TRANSMISSION=y

# Enable logging with floating point support
CONFIG_LOG=y
CONFIG_CBPRINTF_FP_SUPPORT=y

# Increased stack size
CONFIG_MAIN_STACK_SIZE=4096

# Enable base64 encoding and decoding
CONFIG_BASE64=y

# Enable system hashmaps
CONFIG_SYS_HASH_MAP=y
CONFIG_SYS_HASH_FUNC32=y

# Enable JSON library
CONFIG_JSON_LIBRARY=y

# Enable entropy generator
CONFIG_ENTROPY_GENERATOR=y

# DNS resolver
CONFIG_DNS_RESOLVER=y
CONFIG_DNS_SERVER_IP_ADDRESSES=y
CONFIG_DNS_SERVER1="8.8.8.8" # Google DNS

# MbedTLS
CONFIG_MBEDTLS=y
CONFIG_MBEDTLS_BUILTIN=y
CONFIG_MBEDTLS_ENABLE_HEAP=y
# 55kB is the max absolute value, could be set much lower
CONFIG_MBEDTLS_HEAP_SIZE=55000
# 16384 is the max absolute value, could be set much lower
CONFIG_MBEDTLS_SSL_MAX_CONTENT_LEN=16384
CONFIG_MBEDTLS_PEM_CERTIFICATE_FORMAT=y # Does not include writing
CONFIG_MBEDTLS_PK_WRITE_C=y # Required for PEM writing (also needs MBEDTLS_PEM_WRITE_C)
CONFIG_MBEDTLS_ENTROPY_ENABLED=y
CONFIG_MBEDTLS_ZEPHYR_ENTROPY=y
CONFIG_MBEDTLS_USER_CONFIG_ENABLE=y
CONFIG_MBEDTLS_USER_CONFIG_FILE="../samples/common/include/tls-conf.h"
CONFIG_MBEDTLS_TLS_VERSION_1_2=y
CONFIG_MBEDTLS_CIPHER=y
CONFIG_MBEDTLS_CIPHER_ALL_ENABLED=y
CONFIG_MBEDTLS_SERVER_NAME_INDICATION=y
CONFIG_MBEDTLS_KEY_EXCHANGE_ALL_ENABLED=y
CONFIG_MBEDTLS_HASH_ALL_ENABLED=y
CONFIG_MBEDTLS_CTR_DRBG_ENABLED=y
CONFIG_MBEDTLS_HMAC_DRBG_ENABLED=y
CONFIG_MBEDTLS_CHACHAPOLY_AEAD_ENABLED=y
CONFIG_MBEDTLS_ECDH_C=y
CONFIG_MBEDTLS_ECDSA_C=y
CONFIG_MBEDTLS_ECJPAKE_C=y
CONFIG_MBEDTLS_ECP_C=y
CONFIG_MBEDTLS_ECP_ALL_ENABLED=y
CONFIG_MBEDTLS_GENPRIME_ENABLED=y
CONFIG_MBEDTLS_PKCS5_C=y
CONFIG_MBEDTLS_X509_CRL_PARSE_C=y
CONFIG_MBEDTLS_X509_CSR_PARSE_C=y
CONFIG_MBEDTLS_X509_CSR_WRITE_C=y

# Enable networking
CONFIG_NETWORKING=y

# Sockets
CONFIG_NET_SOCKETS=y
CONFIG_NET_SOCKETS_POLL_MAX=4
CONFIG_NET_SOCKETS_SOCKOPT_TLS=y

# Use DHCP for IPv4 and IPv6
CONFIG_NET_DHCPV4=y
CONFIG_NET_DHCPV6=y

# Generic networking options
CONFIG_NET_TX_STACK_SIZE=2048
CONFIG_NET_RX_STACK_SIZE=2048
CONFIG_NET_PKT_RX_COUNT=10
CONFIG_NET_PKT_TX_COUNT=10
CONFIG_NET_BUF_RX_COUNT=20
CONFIG_NET_BUF_TX_COUNT=20
CONFIG_NET_MAX_CONTEXTS=10
CONFIG_NET_MGMT=y
CONFIG_NET_MGMT_EVENT=y
CONFIG_NET_IPV4=y
CONFIG_NET_IPV6=y
CONFIG_NET_TCP=y

# Enable HTTP client
CONFIG_HTTP_CLIENT=y

# MQTT options
CONFIG_MQTT_LIB=y
CONFIG_MQTT_LIB_TLS=y
CONFIG_MQTT_KEEPALIVE=60

# Enable flash
CONFIG_FLASH=y
CONFIG_FLASH_MAP=y
CONFIG_FLASH_PAGE_LAYOUT=y

# Enable NVS
CONFIG_NVS=y
CONFIG_NVS_LOG_LEVEL_WRN=y
```

## boards/esp_wrover_kit_esp32_procpu.conf
```kconfig
# (C) Copyright 2026, SECO Mind Srl
#
# SPDX-License-Identifier: Apache-2.0

# Wi-Fi Configuration
CONFIG_WIFI=y
CONFIG_WIFI_ESP32=y

# increase network buffer size to avoid first connection attempt error
CONFIG_NET_BUF_TX_COUNT=64
CONFIG_NET_BUF_RX_COUNT=64

# ESP32 hardware random number generator is required for secure TLS
CONFIG_ENTROPY_ESP32_RNG=y

# Enable WROVER PSRAM
CONFIG_ESP_SPIRAM=y
# 2MB instead of deafult 256KB
CONFIG_ESP_SPIRAM_HEAP_SIZE=2097152

# Optimizations to save internal RAM used by the Wi-Fi driver
CONFIG_ESP_WIFI_HEAP_SPIRAM=y
CONFIG_ESP32_WIFI_NET_ALLOC_SPIRAM=y
CONFIG_ESP32_WIFI_RX_IRAM_OPT=n
CONFIG_ESP32_WIFI_IRAM_OPT=n

# Use a large log buffer size
CONFIG_LOG_BUFFER_SIZE=32768
```

## boards/esp_wrover_kit_esp32_procpu.overlay
```dts
/*
 * (C) Copyright 2026, SECO Mind Srl
 *
 * SPDX-License-Identifier: Apache-2.0
 */

/delete-node/ &storage_partition;

&flash0 {
	partitions {
		compatible = "fixed-partitions";
		#address-cells = <1>;
		#size-cells = <1>;

        storage_partition: partition@3b0000 {
			label = "storage";
			reg = <0x3B0000 DT_SIZE_K(128)>;
		};

		astarte_partition: partition@3d0000 {
			label = "astarte";
			reg = <0x003D0000 DT_SIZE_K(64)>;
		};
	};
};
```

## src/main.c
```c
/*
 * (C) Copyright 2024, SECO Mind Srl
 *
 * SPDX-License-Identifier: Apache-2.0
 */

#include <string.h>

#include <zephyr/data/json.h>
#include <zephyr/kernel.h>
#include <zephyr/logging/log.h>
#include <zephyr/net/http/client.h>
#include <zephyr/net/socket.h>
#include <zephyr/posix/arpa/inet.h>
#include <zephyr/toolchain.h>

#if (!defined(CONFIG_ASTARTE_DEVICE_SDK_DEVELOP_USE_NON_TLS_HTTP)                                  \
    || !defined(CONFIG_ASTARTE_DEVICE_SDK_DEVELOP_USE_NON_TLS_MQTT))
#include "ca_certificates.h"
#include <zephyr/net/tls_credentials.h>
#endif

#include <astarte_device_sdk/data.h>
#include <astarte_device_sdk/device.h>
#include <astarte_device_sdk/interface.h>
#include <astarte_device_sdk/mapping.h>
#include <astarte_device_sdk/pairing.h>

#ifdef CONFIG_WIFI
#include "wifi.h"
#else
#include "eth.h"
#endif

#include "utils.h"

#include "generated_interfaces.h"

#ifdef CONFIG_DEVICE_INDIVIDUAL_TRANSMISSION
#include "individual_send.h"
#endif
#ifdef CONFIG_DEVICE_OBJECT_TRANSMISSION
#include "object_send.h"
#endif
#if defined(CONFIG_DEVICE_PROPERTY_SET_TRANSMISSION)                                               \
    || defined(CONFIG_DEVICE_PROPERTY_UNSET_TRANSMISSION)
#include "property_send.h"
#endif
#ifdef CONFIG_DEVICE_REGISTRATION
#include "register.h"
#endif

#include "sample_config.h"

/************************************************
 * Constants, static variables and defines
 ***********************************************/

LOG_MODULE_REGISTER(main, CONFIG_APP_LOG_LEVEL); // NOLINT

#define THREAD_SLEEP_MS 500

// NOLINTBEGIN(cppcoreguidelines-avoid-non-const-global-variables)
K_MSGQ_DEFINE(device_msgq, sizeof(astarte_device_handle_t), 1, 1);

enum thread_flags
{
    THREAD_FLAGS_CONNECTED = 1U,
    THREAD_FLAGS_TX_COMPLETE,
    THREAD_FLAGS_RX_TERMINATION,
};
static atomic_t device_thread_flags;

K_THREAD_STACK_DEFINE(device_rx_thread_stack_area, CONFIG_DEVICE_RX_THREAD_STACK_SIZE);
static struct k_thread device_rx_thread_data;

K_THREAD_STACK_DEFINE(device_tx_thread_stack_area, CONFIG_DEVICE_TX_THREAD_STACK_SIZE);
static struct k_thread device_tx_thread_data;
// NOLINTEND(cppcoreguidelines-avoid-non-const-global-variables)

/************************************************
 * Static functions declaration
 ***********************************************/

/**
 * @brief Entry point for the Astarte device reception thread.
 *
 * @param device_id Device id for the Astarte device.
 * @param cred_secr/arg2 Unused argument or credential secret.
 * @param arg3 Unused argument.
 */
#if CONFIG_DEVICE_REGISTRATION
static void device_rx_thread_entry_point(void *device_id, void *arg2, void *arg3);
#else
static void device_rx_thread_entry_point(void *device_id, void *cred_secr, void *arg3);
#endif
/**
 * @brief Entry point for the Astarte device transmission thread.
 *
 * @param arg1 Unused argument.
 * @param arg2 Unused argument.
 * @param arg3 Unused argument.
 */
static void device_tx_thread_entry_point(void *arg1, void *arg2, void *arg3);
/**
 * @brief Callback handler for Astarte connection events.
 *
 * @param event Astarte device connection event.
 */
static void connection_callback(astarte_device_connection_event_t event);
/**
 * @brief Callback handler for Astarte disconnection events.
 *
 * @param event Astarte device disconnection event.
 */
static void disconnection_callback(astarte_device_disconnection_event_t event);
/**
 * @brief Callback handler for Astarte datastream individual event.
 *
 * @param event Astarte device datastream individual event.
 */
static void datastream_individual_callback(astarte_device_datastream_individual_event_t event);
/**
 * @brief Callback handler for Astarte datastream object event.
 *
 * @param event Astarte device datastream object event.
 */
static void datastream_object_callback(astarte_device_datastream_object_event_t event);
/**
 * @brief Callback handler for Astarte set property event.
 *
 * @param event Astarte device set property event.
 */
static void set_property_callback(astarte_device_property_set_event_t event);
/**
 * @brief Callback handler for Astarte unset property event.
 *
 * @param event Astarte device unset property event.
 */
static void unset_property_callback(astarte_device_data_event_t event);

/************************************************
 * Global functions definition
 ***********************************************/

int main(void)
{
    LOG_INF("Astarte device sample"); // NOLINT
    LOG_INF("Board: %s", CONFIG_BOARD); // NOLINT

    struct sample_config cfg_from_file = { 0 };
    sample_config_get(&cfg_from_file);
    LOG_INF("Configured device ID: %s", cfg_from_file.device_id); // NOLINT
#ifndef CONFIG_DEVICE_REGISTRATION
    LOG_INF("Configured credential secret: %s", cfg_from_file.credential_secret); // NOLINT
#endif
#ifdef CONFIG_WIFI
    LOG_INF("Configured WiFi SSID: %s", cfg_from_file.wifi_ssid); // NOLINT
    LOG_INF("Configured WiFi password: %s", cfg_from_file.wifi_pwd); // NOLINT
#endif

#ifdef CONFIG_WIFI
    LOG_INF("Initializing WiFi driver."); // NOLINT
    app_wifi_init();
    k_sleep(K_SECONDS(5));
    enum wifi_security_type sec = WIFI_SECURITY_TYPE_PSK;
    if (app_wifi_connect(cfg_from_file.wifi_ssid, sec, cfg_from_file.wifi_pwd) != 0) {
        LOG_ERR("Connectivity intialization failed!"); // NOLINT
        return -1;
    }
#else
    // Initialize Ethernet driver
    LOG_INF("Initializing Ethernet driver."); // NOLINT
    if (eth_connect() != 0) {
        LOG_ERR("Connectivity intialization failed!"); // NOLINT
        return -1;
    }
#endif

    // Add TLS certificate if required
#if (!defined(CONFIG_ASTARTE_DEVICE_SDK_DEVELOP_USE_NON_TLS_HTTP)                                  \
    || !defined(CONFIG_ASTARTE_DEVICE_SDK_DEVELOP_USE_NON_TLS_MQTT))
    tls_credential_add(CONFIG_ASTARTE_DEVICE_SDK_HTTPS_CA_CERT_TAG, TLS_CREDENTIAL_CA_CERTIFICATE,
        ca_certificate_root, sizeof(ca_certificate_root));
#endif

    // Spawn new rx thread for the Astarte device
#if CONFIG_DEVICE_REGISTRATION

    k_thread_create(&device_rx_thread_data, device_rx_thread_stack_area,
        K_THREAD_STACK_SIZEOF(device_rx_thread_stack_area), device_rx_thread_entry_point,
        cfg_from_file.device_id, NULL, NULL, CONFIG_DEVICE_THREAD_PRIORITY, 0, K_NO_WAIT);
#else
    k_thread_create(&device_rx_thread_data, device_rx_thread_stack_area,
        K_THREAD_STACK_SIZEOF(device_rx_thread_stack_area), device_rx_thread_entry_point,
        cfg_from_file.device_id, cfg_from_file.credential_secret, NULL,
        CONFIG_DEVICE_THREAD_PRIORITY, 0, K_NO_WAIT);
#endif
    // Spawn new tx thread for the Astarte device
    k_thread_create(&device_tx_thread_data, device_tx_thread_stack_area,
        K_THREAD_STACK_SIZEOF(device_tx_thread_stack_area), device_tx_thread_entry_point, NULL,
        NULL, NULL, CONFIG_DEVICE_THREAD_PRIORITY, 0, K_NO_WAIT);

    while (!atomic_test_bit(&device_thread_flags, THREAD_FLAGS_TX_COMPLETE)) {
#ifndef CONFIG_WIFI
        // Ensure the connectivity is still present
        eth_poll();
#endif
        k_sleep(K_MSEC(THREAD_SLEEP_MS));
    }

    // Ensure the Astarte tx thread has properly terminated and no more data is being sent.
    if (k_thread_join(&device_tx_thread_data, K_FOREVER) != 0) {
        LOG_ERR("Failed in waiting for the Astarte tx thread to terminate."); // NOLINT
    }

    // Signal to the Astarte rx thread that is should terminate.
    atomic_set_bit(&device_thread_flags, THREAD_FLAGS_RX_TERMINATION);

    // Wait for the Astarte rx thread to terminate.
    if (k_thread_join(&device_rx_thread_data, K_FOREVER) != 0) {
        LOG_ERR("Failed in waiting for the Astarte rx threads to terminate."); // NOLINT
    }

    LOG_INF("Astarte device sample finished."); // NOLINT
    k_sleep(K_MSEC(MSEC_PER_SEC));

    return 0;
}

/************************************************
 * Static functions definitions
 ***********************************************/

#if CONFIG_DEVICE_REGISTRATION
static void device_rx_thread_entry_point(void *device_id, void *arg2, void *arg3)
{
    ARG_UNUSED(arg2);
#else
static void device_rx_thread_entry_point(void *device_id, void *cred_secr, void *arg3)
{
#endif
    ARG_UNUSED(arg3);

    astarte_device_handle_t device = NULL;
    astarte_result_t res = ASTARTE_RESULT_OK;

    // Create a new instance of an Astarte device
#if CONFIG_DEVICE_REGISTRATION
    char cred_secr[ASTARTE_PAIRING_CRED_SECR_LEN + 1] = { 0 };
    if (register_device((char *) device_id, cred_secr) != 0) {
        LOG_ERR("Device registration failed, stopping rx thread"); // NOLINT
        k_msgq_put(&device_msgq, (void *) &device, K_FOREVER);
        return;
    }
#endif

    const astarte_interface_t *interfaces[] = {
        &org_astarteplatform_zephyr_examples_DeviceDatastream,
        &org_astarteplatform_zephyr_examples_ServerDatastream,
        &org_astarteplatform_zephyr_examples_DeviceAggregate,
        &org_astarteplatform_zephyr_examples_ServerAggregate,
        &org_astarteplatform_zephyr_examples_DeviceProperty,
        &org_astarteplatform_zephyr_examples_ServerProperty,
    };

    astarte_device_config_t device_config = { 0 };
    device_config.http_timeout_ms = CONFIG_HTTP_TIMEOUT_MS;
    device_config.mqtt_connection_timeout_ms = CONFIG_MQTT_CONNECTION_TIMEOUT_MS;
    device_config.mqtt_poll_timeout_ms = CONFIG_MQTT_POLL_TIMEOUT_MS;
    device_config.connection_cbk = connection_callback;
    device_config.disconnection_cbk = disconnection_callback;
    device_config.datastream_individual_cbk = datastream_individual_callback;
    device_config.datastream_object_cbk = datastream_object_callback;
    device_config.property_set_cbk = set_property_callback;
    device_config.property_unset_cbk = unset_property_callback;
    device_config.interfaces = interfaces;
    device_config.interfaces_size = ARRAY_SIZE(interfaces);
    memcpy(device_config.device_id, device_id, ASTARTE_DEVICE_ID_LEN + 1);
    memcpy(device_config.cred_secr, (const char *) cred_secr, ASTARTE_PAIRING_CRED_SECR_LEN + 1);

    res = astarte_device_new(&device_config, &device);
    if (res != ASTARTE_RESULT_OK) {
        LOG_ERR("Astarte device creation failure."); // NOLINT
        k_msgq_put(&device_msgq, (void *) &device, K_FOREVER);
        return;
    }

    res = astarte_device_connect(device);
    if (res != ASTARTE_RESULT_OK) {
        LOG_ERR("Astarte device connection failure."); // NOLINT
        k_msgq_put(&device_msgq, (void *) &device, K_FOREVER);
        return;
    }

    // Add the message to the queue for the transmit thread
    // NO_WAIT is used since we know we are the only therad writing
    k_msgq_put(&device_msgq, (void *) &device, K_NO_WAIT);

    while (!atomic_test_bit(&device_thread_flags, THREAD_FLAGS_RX_TERMINATION)) {
        k_timepoint_t timepoint = sys_timepoint_calc(K_MSEC(CONFIG_DEVICE_POLL_PERIOD_MS));

        res = astarte_device_poll(device);
        if (res != ASTARTE_RESULT_OK) {
            LOG_ERR("Astarte device poll failure."); // NOLINT
            return;
        }

        k_sleep(sys_timepoint_timeout(timepoint));
    }

    LOG_INF("End of loop, disconnection imminent."); // NOLINT

    res = astarte_device_disconnect(device, K_SECONDS(10));
    if (res != ASTARTE_RESULT_OK) {
        LOG_ERR("Astarte device disconnection failure %s.", astarte_result_to_name(res)); // NOLINT
        return;
    }

    // we wait for a complete disconnection to avoid loosing some messages
    while (atomic_test_bit(&device_thread_flags, THREAD_FLAGS_CONNECTED)) {
        k_sleep(K_MSEC(THREAD_SLEEP_MS));
    }

    LOG_INF("Astarte device will now be destroyed."); // NOLINT
    res = astarte_device_destroy(device);
    if (res != ASTARTE_RESULT_OK) {
        LOG_ERR("Astarte device destroy failure."); // NOLINT
        return;
    }

    LOG_INF("Astarte thread will now be terminated."); // NOLINT

    k_sleep(K_MSEC(MSEC_PER_SEC));
}

static void device_tx_thread_entry_point(void *arg1, void *arg2, void *arg3)
{
    ARG_UNUSED(arg1);
    ARG_UNUSED(arg2);
    ARG_UNUSED(arg3);

    astarte_device_handle_t device = NULL;
    k_msgq_get(&device_msgq, (void *) &device, K_FOREVER);
    if (!device) {
        LOG_ERR("Received a failed device initialization, stopping transmission thread"); // NOLINT
        goto stop_transmission;
    }

    // wait for the device to be connected before sending data
    while (!atomic_test_bit(&device_thread_flags, THREAD_FLAGS_CONNECTED)) {
        k_sleep(K_MSEC(THREAD_SLEEP_MS));
    }

#ifdef CONFIG_DEVICE_INDIVIDUAL_TRANSMISSION
    // NOLINTNEXTLINE
    LOG_INF("Waiting %d seconds to send individuals.",
        CONFIG_DEVICE_INDIVIDUAL_TRANSMISSION_DELAY_SECONDS);
    k_sleep(K_SECONDS(CONFIG_DEVICE_INDIVIDUAL_TRANSMISSION_DELAY_SECONDS));
    sample_individual_transmission(device);
#endif
#ifdef CONFIG_DEVICE_OBJECT_TRANSMISSION
    // NOLINTNEXTLINE
    LOG_INF("Waiting %d seconds to send objects.", CONFIG_DEVICE_OBJECT_TRANSMISSION_DELAY_SECONDS);
    k_sleep(K_SECONDS(CONFIG_DEVICE_OBJECT_TRANSMISSION_DELAY_SECONDS));
    sample_object_transmission(device);
#endif
#ifdef CONFIG_DEVICE_PROPERTY_SET_TRANSMISSION
    // NOLINTNEXTLINE
    LOG_INF("Waiting %d seconds to set properties.",
        CONFIG_DEVICE_PROPERTY_SET_TRANSMISSION_DELAY_SECONDS);
    k_sleep(K_SECONDS(CONFIG_DEVICE_PROPERTY_SET_TRANSMISSION_DELAY_SECONDS));
    sample_property_set_transmission(device);
#endif
#ifdef CONFIG_DEVICE_PROPERTY_UNSET_TRANSMISSION
    // NOLINTNEXTLINE
    LOG_INF("Waiting %d seconds to unset properties.",
        CONFIG_DEVICE_PROPERTY_UNSET_TRANSMISSION_DELAY_SECONDS);
    k_sleep(K_SECONDS(CONFIG_DEVICE_PROPERTY_UNSET_TRANSMISSION_DELAY_SECONDS));
    sample_property_unset_transmission(device);
#endif

#if defined(CONFIG_DEVICE_INDIVIDUAL_TRANSMISSION) || defined(CONFIG_DEVICE_OBJECT_TRANSMISSION)   \
    || defined(CONFIG_DEVICE_PROPERTY_SET_TRANSMISSION)                                            \
    || defined(CONFIG_DEVICE_PROPERTY_UNSET_TRANSMISSION)
    LOG_INF("Transmission completed."); // NOLINT
#else
    // avoid unused device warnings
    (void) device;

    // NOLINTNEXTLINE
    LOG_INF("No transmission to perform. Keeping the device connected for %d seconds",
        CONFIG_DEVICE_OPERATIONAL_TIMEOUT);
    k_sleep(K_SECONDS(CONFIG_DEVICE_OPERATIONAL_TIMEOUT));
#endif

stop_transmission:
    // Signal to the main thread that the transmission is complete and the thread can be joined.
    atomic_set_bit(&device_thread_flags, THREAD_FLAGS_TX_COMPLETE);
}

static void connection_callback(astarte_device_connection_event_t event)
{
    ARG_UNUSED(event);
    LOG_INF("Astarte device connected."); // NOLINT
    atomic_set_bit(&device_thread_flags, THREAD_FLAGS_CONNECTED);
}

static void disconnection_callback(astarte_device_disconnection_event_t event)
{
    ARG_UNUSED(event);
    LOG_INF("Astarte device disconnected"); // NOLINT
    atomic_clear_bit(&device_thread_flags, THREAD_FLAGS_CONNECTED);
}

static void datastream_individual_callback(astarte_device_datastream_individual_event_t event)
{
    const char *interface_name = event.base_event.interface_name;
    const char *path = event.base_event.path;
    astarte_data_t individual = event.data;

    LOG_INF("Datastream individual event, interface: %s, path: %s", interface_name, path); // NOLINT

    utils_log_astarte_data(individual);
}

static void datastream_object_callback(astarte_device_datastream_object_event_t event)
{
    const char *interface_name = event.base_event.interface_name;
    const char *path = event.base_event.path;
    astarte_object_entry_t *entries = event.entries;
    size_t entries_length = event.entries_len;

    LOG_INF("Datastream object event, interface: %s, path: %s", interface_name, path); // NOLINT

    utils_log_astarte_object(entries, entries_length);
}

static void set_property_callback(astarte_device_property_set_event_t event)
{
    const char *interface_name = event.base_event.interface_name;
    const char *path = event.base_event.path;
    astarte_data_t individual = event.data;

    LOG_INF("Property set event, interface: %s, path: %s", interface_name, path); // NOLINT

    utils_log_astarte_data(individual);
}

static void unset_property_callback(astarte_device_data_event_t event)
{
    const char *interface_name = event.interface_name;
    const char *path = event.path;
    LOG_INF("Property unset event, interface: %s, path: %s", interface_name, path); // NOLINT
}
```

## include/ca_certificates.h
```c
/*
 * (C) Copyright 2024, SECO Mind Srl
 *
 * SPDX-License-Identifier: Apache-2.0
 */

#ifndef CA_CERTIFICATES_H
#define CA_CERTIFICATES_H

/* By default only certificates in DER format are supported. If you want to use
 * certificate in PEM format, you can enable support for it in Kconfig.
 */

static const unsigned char ca_certificate_root[]
    = { "-----BEGIN CERTIFICATE-----\n"
        "MIIFazCCA1OgAwIBAgIRAIIQz7DSQONZRGPgu2OCiwAwDQYJKoZIhvcNAQELBQAw\n"
        "TzELMAkGA1UEBhMCVVMxKTAnBgNVBAoTIEludGVybmV0IFNlY3VyaXR5IFJlc2Vh\n"
        "cmNoIEdyb3VwMRUwEwYDVQQDEwxJU1JHIFJvb3QgWDEwHhcNMTUwNjA0MTEwNDM4\n"
        "WhcNMzUwNjA0MTEwNDM4WjBPMQswCQYDVQQGEwJVUzEpMCcGA1UEChMgSW50ZXJu\n"
        "ZXQgU2VjdXJpdHkgUmVzZWFyY2ggR3JvdXAxFTATBgNVBAMTDElTUkcgUm9vdCBY\n"
        "MTCCAiIwDQYJKoZIhvcNAQEBBQADggIPADCCAgoCggIBAK3oJHP0FDfzm54rVygc\n"
        "h77ct984kIxuPOZXoHj3dcKi/vVqbvYATyjb3miGbESTtrFj/RQSa78f0uoxmyF+\n"
        "0TM8ukj13Xnfs7j/EvEhmkvBioZxaUpmZmyPfjxwv60pIgbz5MDmgK7iS4+3mX6U\n"
        "A5/TR5d8mUgjU+g4rk8Kb4Mu0UlXjIB0ttov0DiNewNwIRt18jA8+o+u3dpjq+sW\n"
        "T8KOEUt+zwvo/7V3LvSye0rgTBIlDHCNAymg4VMk7BPZ7hm/ELNKjD+Jo2FR3qyH\n"
        "B5T0Y3HsLuJvW5iB4YlcNHlsdu87kGJ55tukmi8mxdAQ4Q7e2RCOFvu396j3x+UC\n"
        "B5iPNgiV5+I3lg02dZ77DnKxHZu8A/lJBdiB3QW0KtZB6awBdpUKD9jf1b0SHzUv\n"
        "KBds0pjBqAlkd25HN7rOrFleaJ1/ctaJxQZBKT5ZPt0m9STJEadao0xAH0ahmbWn\n"
        "OlFuhjuefXKnEgV4We0+UXgVCwOPjdAvBbI+e0ocS3MFEvzG6uBQE3xDk3SzynTn\n"
        "jh8BCNAw1FtxNrQHusEwMFxIt4I7mKZ9YIqioymCzLq9gwQbooMDQaHWBfEbwrbw\n"
        "qHyGO0aoSCqI3Haadr8faqU9GY/rOPNk3sgrDQoo//fb4hVC1CLQJ13hef4Y53CI\n"
        "rU7m2Ys6xt0nUW7/vGT1M0NPAgMBAAGjQjBAMA4GA1UdDwEB/wQEAwIBBjAPBgNV\n"
        "HRMBAf8EBTADAQH/MB0GA1UdDgQWBBR5tFnme7bl5AFzgAiIyBpY9umbbjANBgkq\n"
        "hkiG9w0BAQsFAAOCAgEAVR9YqbyyqFDQDLHYGmkgJykIrGF1XIpu+ILlaS/V9lZL\n"
        "ubhzEFnTIZd+50xx+7LSYK05qAvqFyFWhfFQDlnrzuBZ6brJFe+GnY+EgPbk6ZGQ\n"
        "3BebYhtF8GaV0nxvwuo77x/Py9auJ/GpsMiu/X1+mvoiBOv/2X/qkSsisRcOj/KK\n"
        "NFtY2PwByVS5uCbMiogziUwthDyC3+6WVwW6LLv3xLfHTjuCvjHIInNzktHCgKQ5\n"
        "ORAzI4JMPJ+GslWYHb4phowim57iaztXOoJwTdwJx4nLCgdNbOhdjsnvzqvHu7Ur\n"
        "TkXWStAmzOVyyghqpZXjFaH3pO3JLF+l+/+sKAIuvtd7u+Nxe5AW0wdeRlN8NwdC\n"
        "jNPElpzVmbUq4JUagEiuTDkHzsxHpFKVK7q4+63SM1N95R1NbdWhscdCb+ZAJzVc\n"
        "oyi3B43njTOQ5yOf+1CceWxG1bQVs5ZufpsMljq4Ui0/1lvh+wjChP4kqKOJ2qxq\n"
        "4RgqsahDYVvTH9w7jXbyLeiNdd8XM2w9U/t7y0Ff/9yi0GE44Za4rF2LN9d11TPA\n"
        "mRGunUHBcnWEvgJBQl9nJEiU0Zsnvgc/ubhPgXRR4Xq37Z0j4r7g1SgEEzwxA57d\n"
        "emyPxgcYxn/eR44/KJ4EBs+lVDR3veyJm+kXQ99b21/+jh5Xos1AnX5iItreGCc=\n"
        "-----END CERTIFICATE-----\n" };

#endif /* CA_CERTIFICATES_H */
```

## include/sample_config.h
```c
/*
 * (C) Copyright 2025, SECO Mind Srl
 *
 * SPDX-License-Identifier: Apache-2.0
 */

#ifndef SAMPLE_CONFIG_H
#define SAMPLE_CONFIG_H

#include <stdbool.h>
#include <stddef.h>

#include <astarte_device_sdk/device.h>

#ifdef CONFIG_WIFI
#define SAMPLE_CONFIG_WIFI_MAX_STRINGS 255
#endif

struct sample_config
{
    char device_id[ASTARTE_DEVICE_ID_LEN + 1];
#ifndef CONFIG_DEVICE_REGISTRATION
    char credential_secret[ASTARTE_PAIRING_CRED_SECR_LEN + 1];
#endif
#ifdef CONFIG_WIFI
    char wifi_ssid[SAMPLE_CONFIG_WIFI_MAX_STRINGS];
    char wifi_pwd[SAMPLE_CONFIG_WIFI_MAX_STRINGS];
#endif
};

int sample_config_get(struct sample_config *cfg);

#endif /* SAMPLE_CONFIG_H */
```

## src/config_file.c
```c
/*
 * (C) Copyright 2025, SECO Mind Srl
 *
 * SPDX-License-Identifier: Apache-2.0
 */

#include "sample_config.h"

#include <stdint.h>
#include <stdio.h>

#ifdef CONFIG_GET_CONFIG_FROM_FLASH
#include <zephyr/data/json.h>
#include <zephyr/device.h>
#include <zephyr/fs/fs.h>
#include <zephyr/fs/littlefs.h>
#include <zephyr/kernel.h>
#include <zephyr/logging/log.h>
#include <zephyr/storage/flash_map.h>
#endif

#include <zephyr/logging/log.h>
LOG_MODULE_REGISTER(config_file, CONFIG_APP_LOG_LEVEL); // NOLINT

/************************************************
 *       Checks over configuration values       *
 ***********************************************/

#ifndef CONFIG_GET_CONFIG_FROM_FLASH
BUILD_ASSERT(sizeof(CONFIG_DEVICE_ID) == ASTARTE_DEVICE_ID_LEN + 1,
    "Missing device ID in datastreams example");

#ifndef CONFIG_DEVICE_REGISTRATION
BUILD_ASSERT(sizeof(CONFIG_CREDENTIAL_SECRET) == ASTARTE_PAIRING_CRED_SECR_LEN + 1,
    "Missing credential secret in datastreams example");
#endif
#endif

/************************************************
 *        Defines, constants and typedef        *
 ***********************************************/

#ifdef CONFIG_GET_CONFIG_FROM_FLASH
/* Matches LFS_NAME_MAX */
#define MAX_PATH_LEN 255
#define MAX_CONFIG_FILE_SIZE 4096

#define PARTITION_NODE DT_NODELABEL(lfs1)

#if DT_NODE_EXISTS(PARTITION_NODE)
FS_FSTAB_DECLARE_ENTRY(PARTITION_NODE);
#else /* PARTITION_NODE */
#error "Could not find the littlefs partition!"
#endif /* PARTITION_NODE */

struct fs_mount_t *mountpoint = &FS_FSTAB_ENTRY(PARTITION_NODE);
#endif

/************************************************
 *         Static functions declaration         *
 ***********************************************/

static int copy_configuration(const char *device_id, const char *credential_secret,
    const char *wifi_ssid, const char *wifi_pwd, struct sample_config *out_cfg);
#ifdef CONFIG_GET_CONFIG_FROM_FLASH
static int read_configuration_file(
    char fname[static MAX_PATH_LEN], char fcontent[static MAX_CONFIG_FILE_SIZE]);
static int parse_configuration_file(char *fcontent, struct sample_config *out_cfg);
#endif

/************************************************
 * Global functions definition
 ***********************************************/

int sample_config_get(struct sample_config *cfg)
{
#ifdef CONFIG_GET_CONFIG_FROM_FLASH
    int rc;
    char config_fname[MAX_PATH_LEN] = { 0 };
    char config_fcontent[MAX_CONFIG_FILE_SIZE] = { 0 };

    rc = snprintf(
        config_fname, sizeof(config_fname), "%s/configuration.json", mountpoint->mnt_point);
    if (rc >= sizeof(config_fname)) {
        LOG_ERR("FAIL: snprinf [rd:%d]", rc); // NOLINT
        goto out;
    }

    rc = read_configuration_file(config_fname, config_fcontent);
    if (rc < 0) {
        goto out;
    }
    LOG_DBG("%s read content:%s (bytes: %d)", config_fname, config_fcontent, rc); // NOLINT

    rc = parse_configuration_file(config_fcontent, cfg);
    if (rc != 0) {
        goto out;
    }

out:
    rc = fs_unmount(mountpoint);
    LOG_INF("%s unmount: %d", mountpoint->mnt_point, rc); // NOLINT
    if (rc != 0) {
        return -1;
    }
    return 0;
#else
    return copy_configuration(CONFIG_DEVICE_ID,
#ifndef CONFIG_DEVICE_REGISTRATION
        CONFIG_CREDENTIAL_SECRET,
#else
        NULL,
#endif
#ifdef CONFIG_WIFI
        CONFIG_WIFI_SSID, CONFIG_WIFI_PASSWORD,
#else
        NULL, NULL,
#endif
        cfg);
#endif
}

/************************************************
 * Static functions definitions
 ***********************************************/

static int copy_configuration(const char *device_id, const char *credential_secret,
    const char *wifi_ssid, const char *wifi_pwd, struct sample_config *out_cfg)
{
    // Copy the received credential secret in the output buffer
    int snprintf_rc = snprintf(out_cfg->device_id, ARRAY_SIZE(out_cfg->device_id), "%s", device_id);
    if ((snprintf_rc < 0) || (snprintf_rc >= ARRAY_SIZE(out_cfg->device_id))) {
        LOG_ERR("Error extracting the device ID from the parsed json."); // NOLINT
        return -1;
    }
#ifndef CONFIG_DEVICE_REGISTRATION
    snprintf_rc = snprintf(out_cfg->credential_secret, ARRAY_SIZE(out_cfg->credential_secret), "%s",
        credential_secret);
    if ((snprintf_rc < 0) || (snprintf_rc >= ARRAY_SIZE(out_cfg->credential_secret))) {
        LOG_ERR("Error extracting the credential secret from the parsed json."); // NOLINT
        return -1;
    }
#else
    ARG_UNUSED(credential_secret);
#endif
#ifdef CONFIG_WIFI
    snprintf_rc = snprintf(out_cfg->wifi_ssid, ARRAY_SIZE(out_cfg->wifi_ssid), "%s", wifi_ssid);
    if ((snprintf_rc < 0) || (snprintf_rc >= ARRAY_SIZE(out_cfg->wifi_ssid))) {
        LOG_ERR("Error extracting the WiFi SSID from the parsed json."); // NOLINT
        return -1;
    }
    snprintf_rc = snprintf(out_cfg->wifi_pwd, ARRAY_SIZE(out_cfg->wifi_pwd), "%s", wifi_pwd);
    if ((snprintf_rc < 0) || (snprintf_rc >= ARRAY_SIZE(out_cfg->wifi_pwd))) {
        LOG_ERR("Error extracting the WiFi password from the parsed json."); // NOLINT
        return -1;
    }
#else
    ARG_UNUSED(wifi_ssid);
    ARG_UNUSED(wifi_pwd);
#endif
    return 0;
}
#ifdef CONFIG_GET_CONFIG_FROM_FLASH
static int read_configuration_file(
    char fname[static MAX_PATH_LEN], char fcontent[static MAX_CONFIG_FILE_SIZE])
{
    struct fs_file_t file;
    int rc, ret;

    fs_file_t_init(&file);
    rc = fs_open(&file, fname, FS_O_READ);
    if (rc < 0) {
        LOG_ERR("FAIL: open %s: %d", fname, rc); // NOLINT
        return rc;
    }

    rc = fs_read(&file, fcontent, MAX_CONFIG_FILE_SIZE);
    if (rc <= 0) {
        LOG_ERR("FAIL: read %s: [rd:%d]", fname, rc); // NOLINT
        goto out;
    }

out:
    ret = fs_close(&file);
    if (ret < 0) {
        LOG_ERR("FAIL: close %s: %d", fname, ret); // NOLINT
        return ret;
    }

    return rc;
}

static int parse_configuration_file(char *fcontent, struct sample_config *out_cfg)
{
    // Define the structure of the expected JSON file
    struct full_json_s
    {
        const char *deviceID;
        const char *credentialSecret;
        const char *wifiSsid;
        const char *wifiPassword;
    };
    // Create the descriptors list containing each element of the struct
    static const struct json_obj_descr full_json_descr[] = {
        JSON_OBJ_DESCR_PRIM(struct full_json_s, deviceID, JSON_TOK_STRING),
        JSON_OBJ_DESCR_PRIM(struct full_json_s, credentialSecret, JSON_TOK_STRING),
        JSON_OBJ_DESCR_PRIM(struct full_json_s, wifiSsid, JSON_TOK_STRING),
        JSON_OBJ_DESCR_PRIM(struct full_json_s, wifiPassword, JSON_TOK_STRING),
    };
    // This is only for the outside level, nested elements should be checked individually.
    int expected_return_code = (1U << (size_t) ARRAY_SIZE(full_json_descr)) - 1;
    // Parse the json into a structure
    struct full_json_s parsed_json = { 0 };
    int64_t ret = json_obj_parse(
        fcontent, strlen(fcontent) + 1, full_json_descr, ARRAY_SIZE(full_json_descr), &parsed_json);
    if (ret != expected_return_code) {
        LOG_ERR("JSON Parse Error: %lld", ret); // NOLINT
        return -1;
    }
    if (!parsed_json.deviceID) {
        LOG_ERR("Parsed JSON is missing the deviceID field."); // NOLINT
        return -1;
    }
    if (!parsed_json.credentialSecret) {
        LOG_ERR("Parsed JSON is missing the credentialSecret field."); // NOLINT
        return -1;
    }
#ifdef CONFIG_WIFI
    if (!parsed_json.wifiSsid) {
        LOG_ERR("Parsed JSON is missing the wifiSsid field."); // NOLINT
        return -1;
    }
    if (!parsed_json.wifiPassword) {
        LOG_ERR("Parsed JSON is missing the wifiPassword field."); // NOLINT
        return -1;
    }
#endif

    // Copy the received credential secret in the output buffer
    return copy_configuration(parsed_json.deviceID, parsed_json.credentialSecret,
        parsed_json.wifiSsid, parsed_json.wifiPassword, out_cfg);
}
#endif
```

## src/wifi.c
```c
/*
 * (C) Copyright 2025, SECO Mind Srl
 *
 * SPDX-License-Identifier: Apache-2.0
 */

#include "wifi.h"

#include <zephyr/kernel.h>
#include <zephyr/net/wifi_mgmt.h>

#include <zephyr/logging/log.h>
LOG_MODULE_REGISTER(wifi, CONFIG_APP_LOG_LEVEL); // NOLINT

/************************************************
 *        Defines, constants and typedef        *
 ***********************************************/

#define WIFI_SHELL_MGMT_EVENTS (NET_EVENT_WIFI_CONNECT_RESULT | NET_EVENT_WIFI_DISCONNECT_RESULT)

static struct net_mgmt_event_callback wifi_shell_mgmt_cb;
static struct net_mgmt_event_callback ipv4_cb;

static K_SEM_DEFINE(wifi_connected, 0, 1);
static K_SEM_DEFINE(ipv4_address_obtained, 0, 1);

/************************************************
 *       Callbacks declaration/definition       *
 ***********************************************/

static void wifi_mgmt_event_handler(
    struct net_mgmt_event_callback *event_cb, uint64_t mgmt_event, struct net_if *iface)
{
    const struct wifi_status *status = (const struct wifi_status *) event_cb->info;
    switch (mgmt_event) {
        case NET_EVENT_WIFI_CONNECT_RESULT:
            if (status->status) {
                LOG_DBG("WiFi connection request failed (%d)", status->status);
                k_sem_take(&wifi_connected, K_NO_WAIT);
            } else {
                LOG_DBG("WiFi connected");
                k_sem_give(&wifi_connected);
            }
            break;
        case NET_EVENT_WIFI_DISCONNECT_RESULT:
            if (status->status) {
                LOG_DBG("WiFi disconnection error, status: (%d)", status->status);
                k_sem_take(&wifi_connected, K_NO_WAIT);
            } else {
                LOG_DBG("WiFi disconnected");
                k_sem_take(&wifi_connected, K_NO_WAIT);
            }
            break;
        default:
            break;
    }
}

static void ipv4_mgmt_event_handler(
    struct net_mgmt_event_callback *event_cb, uint64_t mgmt_event, struct net_if *iface)
{
    (void) event_cb;
    (void) iface;

    switch (mgmt_event) {

        case NET_EVENT_IPV4_ADDR_ADD:
            LOG_DBG("Network event: NET_EVENT_IPV4_ADDR_ADD."); // NOLINT
            k_sem_give(&ipv4_address_obtained);
            break;

        case NET_EVENT_IPV4_ADDR_DEL:
            LOG_DBG("Network event: NET_EVENT_IPV4_ADDR_DEL."); // NOLINT
            k_sem_take(&ipv4_address_obtained, K_NO_WAIT);
            break;

        default:
            break;
    }
}

/************************************************
 *         Global functions definitions         *
 ***********************************************/

void app_wifi_init(void)
{
    net_mgmt_init_event_callback(
        &wifi_shell_mgmt_cb, wifi_mgmt_event_handler, WIFI_SHELL_MGMT_EVENTS);
    net_mgmt_init_event_callback(
        &ipv4_cb, ipv4_mgmt_event_handler, NET_EVENT_IPV4_ADDR_ADD | NET_EVENT_IPV4_ADDR_DEL);

    net_mgmt_add_event_callback(&wifi_shell_mgmt_cb);
    net_mgmt_add_event_callback(&ipv4_cb);
}

int app_wifi_connect(const char *ssid, enum wifi_security_type sec, const char *psk)
{
    LOG_INF("Connecting through wifi..."); // NOLINT

    struct net_if *iface = net_if_get_wifi_sta();
    struct wifi_connect_req_params cnx_params = { 0 };
    int ret;

    cnx_params.band = WIFI_FREQ_BAND_UNKNOWN;
    cnx_params.channel = WIFI_CHANNEL_ANY;
    cnx_params.security = WIFI_SECURITY_TYPE_NONE;
    cnx_params.mfp = WIFI_MFP_OPTIONAL;

    cnx_params.ssid = ssid;
    cnx_params.ssid_length = strlen(cnx_params.ssid);
    cnx_params.security = sec;
    cnx_params.psk = psk;
    cnx_params.psk_length = strlen(cnx_params.psk);

    ret = net_mgmt(
        NET_REQUEST_WIFI_CONNECT, iface, &cnx_params, sizeof(struct wifi_connect_req_params));
    if (ret) {
        LOG_ERR("Connection request failed with error: %d", ret);
        return -ENOEXEC;
    }

    LOG_INF("Waiting for WiFi to be connected.");
    while (k_sem_count_get(&wifi_connected) == 0) {
        k_sleep(K_MSEC(200));
    }

    net_dhcpv4_start(iface);

    LOG_INF("Waiting for an IPv4 address (DHCP)."); // NOLINT
    while (k_sem_count_get(&ipv4_address_obtained) == 0) {
        k_sleep(K_MSEC(200));
    }

    LOG_INF("WiFi ready..."); // NOLINT

    return 0;
}
```
